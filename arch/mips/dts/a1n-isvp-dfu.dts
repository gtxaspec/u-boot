// SPDX-License-Identifier: GPL-2.0+
/dts-v1/;
#include "a1-isvp-dfu.dtsi"

/ {
	model = "Ingenic ISVP-A1N (DFU loader)";
};

/* A1N: DDR3 W632GU6NG, 256 MiB. DFU loader, SFC-NOR target. */
&ddr {
	ingenic,sdram-params = <
		0x00000000 0x00000002	/* type family */
		0x00000010 0x10000000 0x00000000	/* bus_width chip0_size chip1_size */
		0x5f5e1000 0x2faf0800	/* mpll_hz ddr_hz */
		0x05c05100 0x08605100 0x00000000	/* apll mpll vpll _mnod */
		0x4a004a35 0x0000b092 0x00000002 0x000020f0 0x00003000 0x41c30081	/* cfg ctrl dlmr mmap0 mmap1 refcnt */
		0x07130d08 0x0809070b 0x030c040c 0x252b1f07 0x80069055	/* timing1..5 */
		0x40000c41 0x00000000 0x00000001 0x00000001	/* autosr_cnt autosr_en hregpro pregpro */
		0x11111111 0x00000113	/* cguc0 cguc1 */
		0x0000000a 0x0000000b 0x00000008	/* memcfg cl cwl */
		0x00001f70 0x00010006 0x00020018 0x00030000 0x00000000 0x00000000	/* mr0 mr1 mr2 mr3 mr10 mr63 */
		0x030f0e0d 0x07060504 0x0b0a0908 0x0201000c 0x13121110	/* remap1..5 */
		0x00000000 0x00000000 0x00000000 0x00000000 0x00000000 0x00000000 0x00000000 0x00000000 0x00000000 0x00000000 0x00000000 0x00000000 0x00000000 0x00000000 0x00000000 0x00000000 0x00000000 0x00000000 0x00000000	/* par[19] (efuse drive/ODT/skew) */
		0x00000001 0x00000000 0x0000000e 0x0000000e 0x0000000e 0x0000000e	/* a1_phy odt/drvcmd */
		0x00000014 0x00000014 0x00000014 0x00000014 0x00000010 0x00000007 0x00000080 0x00000020 0x00000020	/* a1_phy dq/vref/dqs */
	>;
};
