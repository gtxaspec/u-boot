// SPDX-License-Identifier: GPL-2.0+
/*
 * Ingenic ISVP-T21-HP (DDR2 64 MB M14D5121632A, CPU 1200 MHz / DDR 500 profile), SFC-NOR.
 */

/dts-v1/;

#include "t21-isvp.dtsi"

/ {
	model = "Ingenic ISVP-T21-HP (SFC NOR)";
};

&ddr {
	/* T21-HP: DDR2 64 MB M14D5121632A (4-bank), CPU 1200 / DDR 500 MHz. */
	ingenic,sdram-params = <
		0x03100860 0x07c08820 0x9a073310	/* APLL1200 MPLL1000 CPCCR */
		0 0					/* ddr_cdr (MPLL/2); DDR2 */
		13 10 0 1 0 0				/* row col bank8 cs0 cs1 dw32 */
		0x04000000				/* 64 MB */
		0x0a288a40 0x0000d91e			/* DDRC_CFG DDRC_CTRL */
		0x000020fc 0x00002400 0x00f20001	/* MMAP0 MMAP1 REFCNT */
		0x040e0806 0x02170707 0x2007051e	/* TIMING1..3 */
		0x1a240031 0xff060405 0x32170505	/* TIMING4..6 */
		0x00000e73				/* MR0 */
	>;
};
