// SPDX-License-Identifier: GPL-2.0+
/*
 * Ingenic ISVP-T21N, DFU/USB-boot loader variant.
 */

/dts-v1/;

#include "t21-isvp-dfu.dtsi"

/ {
	model = "Ingenic ISVP-T21N (DFU loader)";
};

&ddr {
	/* T21N: DDR2 64 MB M14D5121632A (4-bank), CPU 864 / DDR 450 MHz. */
	ingenic,sdram-params = <
		0x04704840 0x04a04840 0x9a073310	/* APLL864 MPLL900 CPCCR */
		0 0					/* ddr_cdr (MPLL/2); DDR2 */
		13 10 0 1 0 0				/* row col bank8 cs0 cs1 dw32 */
		0x04000000				/* 64 MB */
		0x0a288a40 0x0000d91e			/* DDRC_CFG DDRC_CTRL */
		0x000020fc 0x00002400 0x00da0001	/* MMAP0 MMAP1 REFCNT */
		0x040e0706 0x02150607 0x2006051b	/* TIMING1..3 */
		0x17240031 0xff060405 0x32150505	/* TIMING4..6 */
		0x00000c73				/* MR0 */
	>;
};
