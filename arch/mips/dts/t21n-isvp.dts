// SPDX-License-Identifier: GPL-2.0+
/*
 * Ingenic ISVP-T21N (DDR2 64 MB M14D5121632A, CPU 864 MHz), SFC-NOR.
 */

/dts-v1/;

#include "t21-isvp.dtsi"

/ {
	model = "Ingenic ISVP-T21N (SFC NOR)";
};

&ddr {
	compatible = "ingenic,t21n-ddr-innophy";
};
