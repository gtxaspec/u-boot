// SPDX-License-Identifier: GPL-2.0+
/*
 * Ingenic ISVP-T23 32 MB DFU/USB-boot loader (DDR2 32 MB M14D2561616A,
 * CPU 1188 MHz).
 *
 * The 32 MB DDR2 init for the T23DL/DN parts: the 64 MB t23n-isvp-dfu
 * loader programs a 64 MB geometry and cannot bring these 32 MB parts
 * up, so they need this loader. DDR params are the same M14D2561616A
 * set as t23dl-isvp.dts (production NOR), kept verbatim.
 */

/dts-v1/;

#include "t23-isvp-dfu.dtsi"

/ {
	model = "Ingenic ISVP-T23 32MB (DFU loader)";
};

&ddr {
	/* T23DL: DDR2 32 MB M14D2561616A (4-bank), CPU 1188 / DDR 600 MHz. */
	ingenic,sdram-params = <
		0x1290d100 0x06405100 0x9a0b5510	/* APLL1188 MPLL1200 CPCCR */
		0 0					/* ddr_cdr (MPLL/2); DDR2 */
		13 9 0 1 0 0				/* row col bank8 cs0 cs1 dw32 */
		0x02000000				/* 32 MB */
		0x09288940 0x0000d91e			/* DDRC_CFG DDRC_CTRL */
		0x000020fe 0x00002200 0x00910003	/* MMAP0 MMAP1 REFCNT */
		0x050f0a06 0x021c0a07 0x200a0722	/* TIMING1..3 */
		0x26240031 0xff060405 0x321c0505	/* TIMING4..6 */
		0x00000f73				/* MR0 */
	>;
};

/*
 * flash@0 declared spi-nand so the NAND stack binds on NAND boards.
 * board_late_init() (arch/mips/mach-xburst/dfu.c) auto-detects NOR vs
 * NAND: on a NOR board the spi-nand probe fails, the node is unbound,
 * and a SPI-NOR is probed on CS0 instead - one loader flashes either.
 */
&sfc {
	flash@0 {
		compatible = "spi-nand";
		reg = <0>;
		spi-max-frequency = <50000000>;
	};
};
