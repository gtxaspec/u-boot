// SPDX-License-Identifier: GPL-2.0+
/*
 * Ingenic ISVP-T23DL (DDR2 32 MB M14D2561616A, CPU 1188 MHz), SFC-NOR.
 */

/dts-v1/;

#include "t23-isvp.dtsi"

/ {
	model = "Ingenic ISVP-T23DL (SFC NOR)";
};

&ddr {
	/* T23DL: DDR2 32 MB M14D2561616A (4-bank), CPU 1188 / DDR 600 MHz. */
	ingenic,sdram-params = <
		0x1290d100 0x06405100 0x9a0b5510	/* APLL1188 MPLL1200 CPCCR */
		0 0					/* ddr_cdr (MPLL/2); DDR2 */
		13 9 0 1 0 0				/* row col bank8 cs0 cs1 dw32 */
		0x02000000				/* 32 MB */
		0x09288940 0x0000d91e			/* DDRC_CFG DDRC_CTRL */
		0x000020fe 0x00002200 0x00910003	/* MMAP0 MMAP1 REFCNT */
		0x050f0a06 0x021c0a07 0x200a0722	/* TIMING1..3 */
		0x26240031 0xff060405 0x321c0505	/* TIMING4..6 */
		0x00000f73				/* MR0 */
	>;
};
