// SPDX-License-Identifier: GPL-2.0+
/*
 * Ingenic ISVP-T23N DFU/USB-boot loader (DDR2 64 MB, CPU 1188 MHz).
 *
 * The T23N DDR2-64M init brings up the low 64 MB of any 64 MB T23
 * part, so this loader doubles as the universal 64 MB DDR2 DFU loader
 * (T23N/ZN/X/N-HP/N-LP). The 32 MB parts (T23DL/DN) use their own
 * loader.
 */

/dts-v1/;

#include "t23-isvp-dfu.dtsi"

/ {
	model = "Ingenic ISVP-T23N (DFU loader)";
};

&ddr {
	/* T23N: DDR2 64 MB M14D5121632A (4-bank), CPU 1188 / DDR 600 MHz. */
	ingenic,sdram-params = <
		0x1290d100 0x06405100 0x9a0b5510	/* APLL1188 MPLL1200 CPCCR */
		0 0					/* ddr_cdr (MPLL/2); DDR2 */
		13 10 0 1 0 0				/* row col bank8 cs0 cs1 dw32 */
		0x04000000				/* 64 MB */
		0x0a288a40 0x0000d91e			/* DDRC_CFG DDRC_CTRL */
		0x000020fc 0x00002400 0x00910003	/* MMAP0 MMAP1 REFCNT */
		0x050f0a06 0x021c0a07 0x200a0722	/* TIMING1..3 */
		0x26240031 0xff060405 0x321c0505	/* TIMING4..6 */
		0x00000f73				/* MR0 */
	>;
};

/*
 * flash@0 declared spi-nand so the NAND stack binds on NAND boards.
 * board_late_init() (arch/mips/mach-xburst/dfu.c) auto-detects NOR vs
 * NAND: on a NOR board the spi-nand probe fails, the node is unbound,
 * and a SPI-NOR is probed on CS0 instead - one loader flashes either.
 */
&sfc {
	flash@0 {
		compatible = "spi-nand";
		reg = <0>;
		spi-max-frequency = <50000000>;
	};
};
