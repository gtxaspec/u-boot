// SPDX-License-Identifier: GPL-2.0+
#include "t23-isvp-uboot-common.dtsi"

#if defined(CONFIG_SPL_MMC)
/ {
	/* MSC/SD boot config (isvp_t23_msc0) reuses the SFC-NOR board .dts. */
	model = "Ingenic ISVP-T23N (MMC0)";
};
#endif
