// SPDX-License-Identifier: GPL-2.0+
/*
 * Ingenic ISVP-T23X DFU/USB-boot loader (DDR2 64 MB, CPU 1000 MHz).
 * Per-variant loader: its own clocks/DDR; do not reuse across variants.
 */

/dts-v1/;

#include "t23-isvp-dfu.dtsi"

/ {
	model = "Ingenic ISVP-T23X (DFU loader)";
};

&ddr {
	/* T23X: DDR2 64 MB M14D5121632A (4-bank), CPU 1000 / DDR 500 MHz. */
	ingenic,sdram-params = <
		0x07d05900 0x07d05900 0x9a073310	/* APLL1000 MPLL1000 CPCCR */
		0 0					/* ddr_cdr (MPLL/2); DDR2 */
		13 10 0 1 0 0				/* row col bank8 cs0 cs1 dw32 */
		0x04000000				/* 64 MB */
		0x0a288a40 0x0000d91e			/* DDRC_CFG DDRC_CTRL */
		0x000020fc 0x00002400 0x00f20001	/* MMAP0 MMAP1 REFCNT */
		0x040e0806 0x02170707 0x2007051e	/* TIMING1..3 */
		0x1a240031 0xff060405 0x32170505	/* TIMING4..6 */
		0x00000f73				/* MR0 */
	>;
};

/*
 * flash@0 declared spi-nand so the NAND stack binds on NAND boards.
 * board_late_init() (arch/mips/mach-xburst/dfu.c) auto-detects NOR vs
 * NAND: on a NOR board the spi-nand probe fails, the node is unbound,
 * and a SPI-NOR is probed on CS0 instead - one loader flashes either.
 */
&sfc {
	flash@0 {
		compatible = "spi-nand";
		reg = <0>;
		spi-max-frequency = <50000000>;
	};
};
