// SPDX-License-Identifier: GPL-2.0+
/*
 * Ingenic ISVP-T30X (DDR2 128 MB M14D1G1664A, CPU 864 MHz), SFC-NOR.
 */

/dts-v1/;

#include "t30-isvp.dtsi"

/ {
	model = "Ingenic ISVP-T30X (SFC NOR)";
};

&ddr {
	compatible = "ingenic,t30x-ddr-innophy";
};

/ {
	memory {
		device_type = "memory";
		reg = <0x0 0x08000000>;	/* 128 MB DDR2 */
	};
};
