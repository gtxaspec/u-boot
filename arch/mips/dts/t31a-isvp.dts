// SPDX-License-Identifier: GPL-2.0+
/*
 * Ingenic ISVP-T31A (DDR3 128 MB M15T1G1664A, CPU 1512 MHz), SFC-NOR.
 */

/dts-v1/;

#include "t31-isvp.dtsi"

/ {
	model = "Ingenic ISVP-T31A (SFC NOR)";
};

&ddr {
	/* T31A: DDR3 128 MB M15T1G1664A (8-bank), CPU 1512 / DDR 756 MHz. */
	ingenic,sdram-params = <
		0x07e05100 0x07e05100 0x9a0b5510	/* APLL1512 MPLL1512 CPCCR */
		0 1					/* ddr_cdr (MPLL/2); DDR3 */
		13 10 1 1 0 0				/* row col bank8 cs0 cs1 dw32 */
		0x08000000				/* 128 MB */
		0x0aac8a42 0x0000d91e			/* DDRC_CFG DDRC_CTRL */
		0x000020f8 0x00002800 0x00b60003	/* MMAP0 MMAP1 REFCNT */
		0x06100c06 0x041d0b08 0x210b0627	/* TIMING1..3 */
		0x3c250043 0xff080505 0x80220505	/* TIMING4..6 */
		0x00001c40				/* MR0 */
	>;
};
