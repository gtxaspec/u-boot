// SPDX-License-Identifier: GPL-2.0+
/*
 * Ingenic ISVP-T31LC (DDR2 64 MB M14D5121632A, CPU 1104 MHz), SFC-NOR.
 *
 * Same memory system as T31N; the LC bin runs the vendor clock plan
 * APLL 1104 / MPLL 1000 / DDR 500 (vendor isvp_t31lc: APLL_1104M +
 * DDR_500M). Note the vendor LC loader itself uses a secure-boot SPL
 * format tied to LC silicon; this profile only carries the clock/DDR
 * plan for the mainline loader.
 */

/dts-v1/;

#include "t31-isvp.dtsi"

/ {
	model = "Ingenic ISVP-T31LC (SFC NOR)";
};

&ddr {
	/* T31LC: DDR2 64 MB M14D5121632A (4-bank), CPU 1104 / DDR 500 MHz. */
	ingenic,sdram-params = <
		0x05c05100 0x07d05900 0x9a073310	/* APLL1104 MPLL1000 CPCCR */
		0 0					/* ddr_cdr (MPLL/2); DDR2 */
		13 10 0 1 0 0				/* row col bank8 cs0 cs1 dw32 */
		0x04000000				/* 64 MB */
		0x0a288a40 0x0000d91e			/* DDRC_CFG DDRC_CTRL */
		0x000020fc 0x00002400 0x00f20001	/* MMAP0 MMAP1 REFCNT */
		0x040e0806 0x02170707 0x2007051e	/* TIMING1..3 */
		0x1a240031 0xff060405 0x32170505	/* TIMING4..6 */
		0x00000f73				/* MR0 */
	>;
};
