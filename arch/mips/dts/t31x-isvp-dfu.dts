// SPDX-License-Identifier: GPL-2.0+
/*
 * Ingenic ISVP-T31X DFU/USB-boot loader (DDR2 128 MB, CPU 1392 MHz).
 *
 * Per-variant loader: brings up DDR with the T31X clocks (MPLL 1200) so a
 * future ethernet-in-loader path gets the correct RMII reference. Do not
 * reuse across variants - the MPLL differs (T31N = 1008) and the 50 MHz RMII
 * clock is derived from it.
 */

/dts-v1/;

#include "t31-isvp-dfu.dtsi"

/ {
	model = "Ingenic ISVP-T31X (DFU loader)";
};

&ddr {
	/* T31X USB-boot loader: full vendor-cloner clock+DDR config (CPU src
	 * select 0x6a + APLL 0x04805900, DDR 400 MHz MPLL/3). Captured from the
	 * vendor cloner; 600 MHz corrupts the mask-ROM stage2 cache-writeback on
	 * some boards (Wyze VDB1 T31ZX). */
	ingenic,sdram-params = <
		0x04805900 0x06405100 0x6a0b5510	/* APLL MPLL1200 CPCCR(vendor src) */
		2 0					/* ddr_cdr MPLL/3=400MHz; DDR2 */
		13 10 1 1 0 0				/* row col bank8 cs0 cs1 dw32 */
		0x08000000				/* 128 MB */
		0x0ae88a42 0x0000d91e			/* DDRC_CFG DDRC_CTRL */
		0x000020f8 0x00002800 0x00c20001	/* MMAP0 MMAP1 REFCNT(CON=0xc2) */
		0x030d0606 0x02120707 0x20070417	/* TIMING1..3 */
		0x19640031 0xff060405 0x32120505	/* TIMING4..6 */
		0x00000a73				/* MR0 */
	>;
};

/*
 * flash@0 declared spi-nand so the NAND stack binds on NAND boards.
 * board_late_init() (arch/mips/mach-xburst/dfu.c) auto-detects NOR vs
 * NAND: on a NOR board the spi-nand probe fails, the node is unbound,
 * and a SPI-NOR is probed on CS0 instead - one loader flashes either.
 */
&sfc {
	flash@0 {
		compatible = "spi-nand";
		reg = <0>;
		spi-max-frequency = <50000000>;
	};
};
