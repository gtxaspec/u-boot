// SPDX-License-Identifier: GPL-2.0+
/*
 * Ingenic ISVP-T31X (DDR2 128 MB M14D1G1664A, CPU 1392 MHz), SFC-NOR.
 */

/dts-v1/;

#include "t31-isvp.dtsi"

/ {
	model = "Ingenic ISVP-T31X (SFC NOR)";
};

&ddr {
	/* T31X: DDR2 128 MB M14D1G1664A (8-bank), CPU 1392 / DDR 600 MHz. */
	ingenic,sdram-params = <
		0x07405100 0x06405100 0x9a0b5510	/* APLL1392 MPLL1200 CPCCR */
		0 0					/* ddr_cdr (MPLL/2); DDR2 */
		13 10 1 1 0 0				/* row col bank8 cs0 cs1 dw32 */
		0x08000000				/* 128 MB */
		0x0aa88a42 0x0000d91e			/* DDRC_CFG DDRC_CTRL */
		0x000020f8 0x00002800 0x00910003	/* MMAP0 MMAP1 REFCNT */
		0x050f0a06 0x021c0a07 0x200a0722	/* TIMING1..3 */
		0x26240031 0xff060405 0x321c0505	/* TIMING4..6 */
		0x00000f73				/* MR0 */
	>;
};
