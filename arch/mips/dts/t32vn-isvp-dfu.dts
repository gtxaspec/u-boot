// SPDX-License-Identifier: GPL-2.0+
/*
 * Ingenic ISVP-T32VN DFU/USB-boot loader (DDR3 128 MB @700, CPU 900 MHz).
 *
 * The VN DDR3-128M@700 init is the conservative DDR3 bring-up (the
 * pin-wrap table is unused on T32, so the W631/W632 parts differ only
 * in geometry/timing), making this the universal DDR3 DFU loader: on
 * the 256 MB W632 parts the low 128 MB comes up, which is plenty for
 * flashing. The DDR2 parts use t32lq-isvp-dfu; LPDDR3 (VNP) needs its
 * own loader once hardware is available to validate.
 */

/dts-v1/;

#include "t32-isvp-dfu.dtsi"

/ {
	model = "Ingenic ISVP-T32VN (DFU loader)";
};

&ddr {
	ingenic,sdram-params = <
		1 0x08000000 350000000	/* type size ddr_ck_hz */
		0x04b05101 0x0af05901 0x55794410 0x9a094410	/* cpapcr cpmpcr cpccr_div cpccr_sel */
		0x00040001	/* mstr */
		0x000100ab 0x00450000 0x1d700000 0x00180000 0x00080000	/* init0 init1 init3 init4 init5 */
		0x0b0d170c 0x00030311 0x00000509 0x00002006 0x05020306	/* timing0..4 */
		0x04040302 0x00000000 0x00000404 0x00000802 0x00000000	/* timing5 timing6 timing7 timing8 timing14 */
		0x00151515 0x00000000 0x00000000 0x00001f1f 0x04040404 0x0f0f0f04	/* addrmap1..6 */
		0x00000002 0x00550027 0x0600060c	/* rfshctl3 rfshtmg odtcfg */
		0x06040002 0x00080307 0x80400003	/* dfitmg0 dfitmg1 dfiupd0 */
		0x00000003 0x00000008 0x0000000b 0x00000000	/* phy: channel_en cwl cl al */
		0x00000027 0x00000aac 0x00000002	/* phy: trfc trefi mem_sel */
		0x00000000 0x00000000	/* phy: pllpostdiven pllpostdiv */
	>;
};

/*
 * flash@0 declared spi-nand so the NAND stack binds on NAND boards.
 * board_late_init() (arch/mips/mach-xburst/dfu.c) auto-detects NOR vs
 * NAND: on a NOR board the spi-nand probe fails, the node is unbound,
 * and a SPI-NOR is probed on CS0 instead - one loader flashes either.
 */
&sfc {
	flash@0 {
		compatible = "spi-nand";
		reg = <0>;
		spi-max-frequency = <50000000>;
	};
};
