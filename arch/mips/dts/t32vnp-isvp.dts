// SPDX-License-Identifier: GPL-2.0+
/*
 * Ingenic ISVP-T32VNP (LPDDR3 128 MB W63AH6N2B @700, CPU 900 MHz), SFC-NOR.
 */

/dts-v1/;

#include "t32-isvp.dtsi"

/ {
	model = "Ingenic ISVP-T32VNP (SFC NOR)";
};

&ddr {
	ingenic,sdram-params = <
		2 0x08000000 350000000	/* type size ddr_ck_hz */
		0x04b05101 0x0af05901 0x55794410 0x9a094410	/* cpapcr cpmpcr cpccr_div cpccr_sel */
		0x00040008	/* mstr */
		0x00450001 0x00000000 0x00030019 0x00020000 0x000b0004	/* init0 init1 init3 init4 init5 */
		0x0a12170f 0x00030317 0x03060709 0x00505000 0x07020408	/* timing0..4 */
		0x01010606 0x01010004 0x00000101 0x00000000 0x00000032	/* timing5 timing6 timing7 timing8 timing14 */
		0x00151515 0x00000000 0x00000000 0x00001f1f 0x04040404 0x0f0f0f04	/* addrmap1..6 */
		0x00000002 0x0055002e 0x06000600	/* rfshctl3 rfshtmg odtcfg */
		0x06040002 0x00080307 0x80400003	/* dfitmg0 dfitmg1 dfiupd0 */
		0x00000003 0x00000006 0x0000000b 0x00000000	/* phy: channel_en cwl cl al */
		0x0000002e 0x00000aac 0x00000003	/* phy: trfc trefi mem_sel */
		0x00000000 0x00000000	/* phy: pllpostdiven pllpostdiv */
	>;
};
