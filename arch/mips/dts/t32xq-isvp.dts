// SPDX-License-Identifier: GPL-2.0+
/*
 * Ingenic ISVP-T32XQ (DDR3 256 MB W632GU6NG @900, CPU 1200 MHz), SFC-NOR.
 */

/dts-v1/;

#include "t32-isvp.dtsi"

/ {
	model = "Ingenic ISVP-T32XQ (SFC NOR)";
};

&ddr {
	compatible = "ingenic,t32xq-ddr-innophy";
};
