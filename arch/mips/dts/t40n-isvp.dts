// SPDX-License-Identifier: GPL-2.0+
/dts-v1/;
#include "t40-isvp.dtsi"
#include "t40-isvp-nor.dtsi"

/ {
	model = "Ingenic ISVP-T40N (SFC NOR)";
};

/* T40N (lab silkscreen T40NN): DDR2 M14D5121632A, 128 MiB, SFC-NOR. */
&ddr {
	ingenic,sdram-params = <
		0x00000004 0x00000001	/* type family */
		0x00000020 0x08000000 0x00000000	/* bus_width chip0_size chip1_size */
		0x3b9aca00 0x1dcd6500	/* mpll_hz ddr_hz */
		0x04c05100 0x07d05900 0x00000000	/* apll mpll vpll _mnod */
		0x28002825 0x00008092 0x00000000 0x000020f8 0x00002800 0x21f20081	/* cfg ctrl dlmr mmap0 mmap1 refcnt */
		0x050c0806 0x04060407 0x03080208 0x1e1e1705 0x46000055	/* timing1..5 */
		0x20000f3c 0x00000000 0x00000001 0x00000001	/* autosr_cnt autosr_en hregpro pregpro */
		0x11111111 0x00000113	/* cguc0 cguc1 */
		0x00000011 0x00000007 0x00000005	/* memcfg cl cwl */
		0x00000f73 0x00002040 0x00004000 0x00006000 0x00000000 0x00000000	/* mr0 mr1 mr2 mr3 mr10 mr63 */
		0x00000000 0x00000000 0x00000000 0x00000000 0x00000000	/* remap1..5 */
		0x00000000 0x00000000 0x00000000 0x00000000 0x00000000 0x00000000 0x00000000 0x00000000 0x00000000 0x00000000 0x00000000 0x00000000 0x00000000 0x00000000 0x00000000 0x00000000 0x00000000 0x00000000 0x00000000	/* par[19] (efuse drive/ODT/skew; 0 on T40) */
	>;
};
