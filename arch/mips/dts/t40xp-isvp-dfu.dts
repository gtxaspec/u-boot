// SPDX-License-Identifier: GPL-2.0+
/dts-v1/;
#include "t40-isvp-dfu.dtsi"

/* T40XP: DDR3, 256 MiB. DFU loader, SFC-NAND target. */
&ddr {
	ingenic,variant = "t40xp";
};

/* NAND SPL (mach-xburst/t40/sfc_nand.c) reads the flash in SPL, so the
 * SFC pins must be configured there. */
&pins_sfc {
	bootph-all;
};

&sfc {
	flash@0 {
		compatible = "spi-nand";
		reg = <0>;
		spi-max-frequency = <50000000>;
	};
};
