// SPDX-License-Identifier: GPL-2.0+
/dts-v1/;
#include "t40-isvp.dtsi"
#include "t40-isvp-nand.dtsi"

/* T40XP: DDR3 M15T1G1664A_2C, 256 MiB, SFC-NAND. */
&ddr {
	compatible = "ingenic,t40xp-ddr-innophy";
};
