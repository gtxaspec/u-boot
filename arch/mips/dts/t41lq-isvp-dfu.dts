// SPDX-License-Identifier: GPL-2.0+
/dts-v1/;
#include "t41-isvp-dfu.dtsi"

/ {
	model = "Ingenic ISVP-T41LQ (DFU loader)";
};

/* T41LQ: DDR2 M14D5121632A, 64 MiB. */
&ddr {
	ingenic,sdram-params = <
		0x00000004 0x00000000	/* type family */
		0x00000010 0x04000000 0x00000000	/* bus_width chip0_size chip1_size */
		0x47868c00 0x23c34600	/* mpll_hz ddr_hz */
		0x05b008b0 0x063008b0 0x059008b0	/* apll mpll vpll _mnod */
		0x00002825 0x0000b092 0x00000000 0x000020fc 0x00002400 0x68910083	/* cfg ctrl dlmr mmap0 mmap1 refcnt */
		0x050d0a06 0x04060507 0x030a020a 0x25231c07 0x55000055	/* timing1..5 */
		0x27001249 0x00000000 0x00000001 0x00000001	/* autosr_cnt autosr_en hregpro pregpro */
		0x11111111 0x00000113	/* cguc0 cguc1 */
		0x00000008 0x00000007 0x00000005	/* memcfg cl cwl */
		0x00000173 0x00002040 0x00004000 0x00006000 0x00000000 0x00000000	/* mr0 mr1 mr2 mr3 mr10 mr63 */
		0x03020d0c 0x07060504 0x0b0a0908 0x0f0e0100 0x13121110	/* remap1..5 */
		0x00000000 0x00000000 0x00000005 0x00000005 0x00000005 0x00000005 0x0000000f 0x0000000f 0x0000008b 0x00000002 0x00000000 0x00000004 0x00000015 0x00000015 0x0000000c 0x00000007 0x00000007 0x0000000b 0x00000003	/* par[19] (efuse drive/ODT/skew) */
	>;
};
