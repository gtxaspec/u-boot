## configs/isvp_t23_sfcnor_defconfig
```kconfig
CONFIG_MIPS=y
CONFIG_SKIP_LOWLEVEL_INIT=y
CONFIG_SYS_MALLOC_LEN=0x2000000
CONFIG_SPL_LIBCOMMON_SUPPORT=y
CONFIG_SPL_LIBGENERIC_SUPPORT=y
CONFIG_NR_DRAM_BANKS=1
CONFIG_ENV_SIZE=0x10000
CONFIG_ENV_OFFSET=0x50000
CONFIG_ENV_SECT_SIZE=0x10000
CONFIG_DM_GPIO=y
CONFIG_DEFAULT_DEVICE_TREE="t23-isvp"
CONFIG_SPL_STACK=0x80008000
CONFIG_SPL_TEXT_BASE=0x80001000
CONFIG_SPL_BSS_START_ADDR=0x80005800
CONFIG_SPL_BSS_MAX_SIZE=0x800
CONFIG_SYS_BOOTM_LEN=0x2000000
CONFIG_SYS_LOAD_ADDR=0x80600000
CONFIG_SPL=y
CONFIG_ARCH_XBURST=y
CONFIG_SOC_T23=y
CONFIG_TARGET_ISVP_T23=y
CONFIG_BUILD_TARGET="u-boot-lzma.img"
CONFIG_SYS_MIPS_TIMER_FREQ=1188000000
CONFIG_FIT=y
CONFIG_USE_PREBOOT=y
CONFIG_PREBOOT="sf probe"
CONFIG_DISPLAY_CPUINFO=y
CONFIG_BOARD_INIT=y
CONFIG_SPL_MAX_SIZE=0x5800
# CONFIG_SPL_SHARES_INIT_SP_ADDR is not set
CONFIG_SPL_HAVE_INIT_STACK=y
CONFIG_SPL_SYS_MALLOC=y
CONFIG_CMD_DFU=y
CONFIG_CMD_GPIO=y
CONFIG_CMD_MMC=y
CONFIG_CMD_PART=y
CONFIG_CMD_SPI=y
CONFIG_CMD_USB=y
CONFIG_CMD_USB_MASS_STORAGE=y
CONFIG_CMD_DHCP=y
CONFIG_CMD_PING=y
CONFIG_CMD_SOUND=y
CONFIG_CMD_EXT4=y
CONFIG_CMD_FAT=y
CONFIG_CMD_FS_GENERIC=y
# CONFIG_SPL_DOS_PARTITION is not set
CONFIG_EFI_PARTITION=y
# CONFIG_SPL_EFI_PARTITION is not set
CONFIG_ENV_IS_IN_SPI_FLASH=y
CONFIG_NET_RANDOM_ETHADDR=y
CONFIG_CLK=y
CONFIG_CLK_INGENIC_T23=y
CONFIG_DFU_MMC=y
CONFIG_DFU_RAM=y
CONFIG_DFU_SF=y
CONFIG_MMC=y
CONFIG_JZ47XX_MMC=y
CONFIG_MTD=y
CONFIG_DM_SPI_FLASH=y
CONFIG_SPI_FLASH_SFDP_SUPPORT=y
CONFIG_SPI_FLASH_GIGADEVICE=y
CONFIG_SPI_FLASH_MACRONIX=y
CONFIG_SPI_FLASH_WINBOND=y
CONFIG_SPI_FLASH_XMC=y
CONFIG_SPI_FLASH_ZBIT=y
CONFIG_ETH_DESIGNWARE=y
CONFIG_ETH_DESIGNWARE_INGENIC=y
CONFIG_PHY_ICPLUS=y
CONFIG_PINCTRL=y
CONFIG_PINCTRL_INGENIC=y
CONFIG_DM_SERIAL=y
CONFIG_SYS_NS16550=y
CONFIG_SOUND=y
CONFIG_I2S=y
CONFIG_I2S_INGENIC=y
CONFIG_SOUND_JZ_T10_CODEC=y
CONFIG_SPI=y
CONFIG_DM_SPI=y
CONFIG_SPI_INGENIC=y
CONFIG_SYSRESET=y
CONFIG_SYSRESET_WATCHDOG=y
CONFIG_SYSRESET_WATCHDOG_AUTO=y
CONFIG_USB=y
# CONFIG_SPL_DM_USB is not set
CONFIG_DM_USB_GADGET=y
CONFIG_USB_DWC2=y
CONFIG_USB_STORAGE=y
CONFIG_USB_HOST_ETHER=y
CONFIG_USB_ETHER_ASIX=y
CONFIG_USB_GADGET=y
CONFIG_USB_GADGET_MANUFACTURER="Ingenic"
CONFIG_USB_GADGET_VENDOR_NUM=0xa108
CONFIG_USB_GADGET_PRODUCT_NUM=0x4d44
CONFIG_USB_GADGET_DWC2_OTG=y
CONFIG_USB_GADGET_DOWNLOAD=y
# CONFIG_WATCHDOG is not set
# CONFIG_WATCHDOG_AUTOSTART is not set
CONFIG_WDT_INGENIC=y
CONFIG_FAT_WRITE=y
CONFIG_LZMA=y
CONFIG_SPL_LZMA=y
CONFIG_SPL_LZMA_SIZE_OPTIMIZATION=y
```

## configs/isvp_t30_sfcnor_defconfig
```kconfig
CONFIG_MIPS=y
CONFIG_TEXT_BASE=0x80100000
CONFIG_SYS_MALLOC_LEN=0x2000000
CONFIG_SYS_BOOTM_LEN=0x2000000
CONFIG_NR_DRAM_BANKS=1
CONFIG_DEFAULT_DEVICE_TREE="t30-isvp"
CONFIG_SYS_LOAD_ADDR=0x80600000
CONFIG_ARCH_XBURST=y
CONFIG_SOC_T30=y
CONFIG_TARGET_ISVP_T30=y
CONFIG_SPL=y
CONFIG_SPL_FRAMEWORK=y
CONFIG_SPL_TEXT_BASE=0x80001000
CONFIG_SPL_MAX_SIZE=0x5800
CONFIG_SPL_BSS_START_ADDR=0x80005800
CONFIG_SPL_BSS_MAX_SIZE=0x800
# CONFIG_SPL_SHARES_INIT_SP_ADDR is not set
CONFIG_SPL_HAVE_INIT_STACK=y
CONFIG_SPL_STACK=0x80008000
CONFIG_SPL_LIBGENERIC_SUPPORT=y
CONFIG_SPL_LIBCOMMON_SUPPORT=y
CONFIG_SPL_SYS_MALLOC=y
CONFIG_BUILD_TARGET="u-boot-lzma.img"
CONFIG_LZMA=y
CONFIG_SPL_LZMA=y
CONFIG_SPL_LZMA_SIZE_OPTIMIZATION=y
CONFIG_HUSH_PARSER=y
CONFIG_SYS_MIPS_TIMER_FREQ=750000000
CONFIG_SKIP_LOWLEVEL_INIT=y
CONFIG_DISPLAY_CPUINFO=y
CONFIG_BOARD_INIT=y
CONFIG_OF_CONTROL=y
CONFIG_DM=y
CONFIG_DM_SERIAL=y
CONFIG_SYS_NS16550=y
CONFIG_BAUDRATE=115200
CONFIG_BOOTDELAY=1
CONFIG_USE_PREBOOT=y
CONFIG_PREBOOT="sf probe"
CONFIG_NET=y
CONFIG_NET_RANDOM_ETHADDR=y
CONFIG_CMD_NET=y
CONFIG_CMD_PING=y
CONFIG_CMD_DHCP=y
CONFIG_NETDEVICES=y
CONFIG_DM_ETH=y
CONFIG_PHYLIB=y
CONFIG_PHY_ICPLUS=y
CONFIG_ETH_DESIGNWARE=y
CONFIG_ETH_DESIGNWARE_INGENIC=y
CONFIG_USB=y
CONFIG_DM_USB=y
# CONFIG_SPL_DM_USB is not set
CONFIG_DM_USB_GADGET=y
CONFIG_USB_DWC2=y
CONFIG_CMD_USB=y
CONFIG_USB_STORAGE=y
CONFIG_USB_HOST_ETHER=y
CONFIG_USB_ETHER_ASIX=y
CONFIG_USB_GADGET=y
CONFIG_USB_GADGET_MANUFACTURER="Ingenic"
CONFIG_USB_GADGET_VENDOR_NUM=0xa108
CONFIG_USB_GADGET_PRODUCT_NUM=0x4d44
CONFIG_USB_GADGET_DWC2_OTG=y
CONFIG_USB_GADGET_DOWNLOAD=y
CONFIG_DFU=y
CONFIG_DFU_SF=y
CONFIG_DFU_MMC=y
CONFIG_DFU_RAM=y
CONFIG_CMD_DFU=y
CONFIG_USB_FUNCTION_DFU=y
CONFIG_CMD_USB_MASS_STORAGE=y
CONFIG_USB_FUNCTION_MASS_STORAGE=y
CONFIG_MTD=y
CONFIG_DM_SPI=y
CONFIG_SPI=y
CONFIG_SPI_INGENIC=y
CONFIG_DM_SPI_FLASH=y
CONFIG_SPI_FLASH=y
CONFIG_SPI_FLASH_MACRONIX=y
CONFIG_SPI_FLASH_BOYA=y
CONFIG_SPI_FLASH_EON=y
CONFIG_SPI_FLASH_GALLOP=y
CONFIG_SPI_FLASH_FIDELIX=y
CONFIG_SPI_FLASH_FUDAN=y
CONFIG_SPI_FLASH_GIGADEVICE=y
CONFIG_SPI_FLASH_PUYA=y
CONFIG_SPI_FLASH_WINBOND=y
CONFIG_SPI_FLASH_ZBIT=y
CONFIG_SPI_FLASH_XTX=y
CONFIG_SPI_FLASH_DOSILICON=y
CONFIG_SPI_FLASH_XMC=y
CONFIG_SPI_FLASH_SFDP_SUPPORT=y
CONFIG_CMD_SF=y
CONFIG_CMD_SPI=y
CONFIG_CMD_GPIO=y
CONFIG_BUTTON=y
CONFIG_BUTTON_GPIO=y
CONFIG_BUTTON_CMD=y
CONFIG_BLK=y
CONFIG_CLK=y
CONFIG_CLK_INGENIC_T30=y
CONFIG_SYSRESET=y
CONFIG_SYSRESET_WATCHDOG=y
CONFIG_SYSRESET_WATCHDOG_AUTO=y
CONFIG_WDT=y
CONFIG_WDT_INGENIC=y
# CONFIG_WATCHDOG is not set
# CONFIG_WATCHDOG_AUTOSTART is not set
CONFIG_DM_GPIO=y
CONFIG_PINCTRL=y
CONFIG_PINCTRL_INGENIC=y
CONFIG_MMC=y
CONFIG_DM_MMC=y
CONFIG_JZ47XX_MMC=y
CONFIG_DM_REGULATOR=y
CONFIG_DM_REGULATOR_FIXED=y
CONFIG_CMD_MMC=y
CONFIG_DOS_PARTITION=y
CONFIG_EFI_PARTITION=y
# CONFIG_SPL_PARTITIONS is not set
# CONFIG_SPL_DOS_PARTITION is not set
# CONFIG_SPL_EFI_PARTITION is not set
# CONFIG_SPL_PARTITION_UUIDS is not set
# CONFIG_SPL_BLK is not set
CONFIG_CMD_PART=y
CONFIG_FS_FAT=y
CONFIG_FAT_WRITE=y
CONFIG_CMD_FAT=y
CONFIG_FS_EXT4=y
CONFIG_CMD_EXT4=y
CONFIG_CMD_FS_GENERIC=y
# CONFIG_ENV_IS_NOWHERE is not set
CONFIG_ENV_IS_IN_SPI_FLASH=y
CONFIG_ENV_OFFSET=0x50000
CONFIG_ENV_SIZE=0x10000
CONFIG_ENV_SECT_SIZE=0x10000
CONFIG_SOUND=y
CONFIG_I2S=y
CONFIG_I2S_INGENIC=y
CONFIG_SOUND_JZ_T10_CODEC=y
CONFIG_CMD_SOUND=y
```

## configs/isvp_t31_sfcnor_ddr128M_defconfig
```kconfig
CONFIG_MIPS=y
CONFIG_TEXT_BASE=0x80100000
CONFIG_SYS_MALLOC_LEN=0x2000000
CONFIG_NR_DRAM_BANKS=1
CONFIG_DEFAULT_DEVICE_TREE="t31-isvp"
CONFIG_SYS_LOAD_ADDR=0x82000000
CONFIG_ARCH_XBURST=y
CONFIG_SOC_T31=y
CONFIG_TARGET_ISVP_T31=y
CONFIG_SPL=y
CONFIG_SPL_FRAMEWORK=y
CONFIG_SPL_TEXT_BASE=0x80001000
CONFIG_SPL_MAX_SIZE=0x5800
CONFIG_SPL_BSS_START_ADDR=0x80003000
CONFIG_SPL_BSS_MAX_SIZE=0x800
# CONFIG_SPL_SHARES_INIT_SP_ADDR is not set
CONFIG_SPL_HAVE_INIT_STACK=y
CONFIG_SPL_STACK=0x80008000
CONFIG_SPL_LIBGENERIC_SUPPORT=y
CONFIG_SPL_LIBCOMMON_SUPPORT=y
CONFIG_SYS_MIPS_TIMER_FREQ=1392000000
CONFIG_SKIP_LOWLEVEL_INIT=y
CONFIG_DISPLAY_CPUINFO=y
CONFIG_OF_CONTROL=y
CONFIG_DM=y
CONFIG_DM_SERIAL=y
CONFIG_SYS_NS16550=y
CONFIG_BAUDRATE=115200
CONFIG_FIT=y
CONFIG_USE_PREBOOT=y
CONFIG_PREBOOT="sf probe"
# CONFIG_NET is not set
# CONFIG_NETDEVICES is not set
CONFIG_MTD=y
CONFIG_DM_SPI=y
CONFIG_SPI=y
CONFIG_SPI_INGENIC=y
CONFIG_DM_SPI_FLASH=y
CONFIG_SPI_FLASH=y
CONFIG_SPI_FLASH_WINBOND=y
CONFIG_SPI_FLASH_ZBIT=y
CONFIG_SPI_FLASH_SFDP_SUPPORT=y
CONFIG_CMD_SF=y
CONFIG_CMD_SPI=y
CONFIG_CMD_GPIO=y
CONFIG_BLK=y
CONFIG_DM_GPIO=y
CONFIG_INGENIC_T31_GPIO=y
CONFIG_MMC=y
CONFIG_DM_MMC=y
CONFIG_JZ47XX_MMC=y
CONFIG_CMD_MMC=y
# CONFIG_ENV_IS_NOWHERE is not set
CONFIG_ENV_IS_IN_SPI_FLASH=y
CONFIG_ENV_OFFSET=0x100000
CONFIG_ENV_SIZE=0x10000
CONFIG_ENV_SECT_SIZE=0x10000
```
