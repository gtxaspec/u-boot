## arch/mips/mach-xburst/t33/Kconfig
```kconfig
if SOC_T33

choice
	prompt "T33 SoC variant"
	default T33_VARIANT_L
	help
	  Specific T33 (vendor PRJ008) goat SKU. Authoritative params
	  are the host pll_params_creator / ddr_creator_chip_v3 output
	  for PRJ008_<sku>_goat_sfcnor (verbatim, NOT recomputed):
	    L/DL   DDR2 M14D5121632A 64 MB,  APLL 950 / DDR 650
	    VL/ZL  DDR2 M14D5121632A 64 MB,  APLL 891 / DDR 550
	    N      DDR3 W631GU6NG   128 MB,  APLL 950 / DDR 900
	    VN/ZN  DDR3 W631GU6NG   128 MB,  APLL 891 / DDR 700
	  DL==L, ZL==VL, ZN==VN (vendor bin badge only - param
	  identical). DDR2 = soft-train; DDR3 = hardware-train (a
	  different Innophy PHY path). The W632GU6NG/LPDDR3 PRJ008
	  bins do not exist (those are PRJ007/T32 only).

config T33_VARIANT_L
	bool "T33L (DDR2 650 MHz, 64 MB)"

config T33_VARIANT_DL
	bool "T33DL (DDR2 650 MHz; == L params)"

config T33_VARIANT_VL
	bool "T33VL (DDR2 550 MHz, 64 MB)"

config T33_VARIANT_ZL
	bool "T33ZL (DDR2 550 MHz; == VL params)"

config T33_VARIANT_N
	bool "T33N (DDR3 900 MHz, 128 MB)"

config T33_VARIANT_VN
	bool "T33VN (DDR3 700 MHz, 128 MB)"

config T33_VARIANT_ZN
	bool "T33ZN (DDR3 700 MHz; == VN params)"

endchoice

config T33_VARIANT_NAME
	string
	default "T33DL" if T33_VARIANT_DL
	default "T33VL" if T33_VARIANT_VL
	default "T33ZL" if T33_VARIANT_ZL
	default "T33N"  if T33_VARIANT_N
	default "T33VN" if T33_VARIANT_VN
	default "T33ZN" if T33_VARIANT_ZN
	default "T33L"

# --- internal DDR param-class selectors (one is set per variant) ---
# The mach/t33-ddr.h param chain and t33/pll.c key off these.

config T33_DDR2_550
	bool
	default y if T33_VARIANT_VL || T33_VARIANT_ZL
	help
	  DDR2 VL/ZL: M14D5121632A at 550 MHz (APLL 891 / MPLL
	  1100) vs L/DL 650 (APLL 950 / MPLL 1300). Default DDR2
	  set is L (650).

config T33_DDR3_W631_900
	bool
	default y if T33_VARIANT_N
	help
	  DDR3 W631GU6NG 128 MB at 900 MHz (T33N): APLL 950 /
	  MPLL 1200.

config T33_DDR3_W631_700
	bool
	default y if T33_VARIANT_VN || T33_VARIANT_ZN
	help
	  DDR3 W631GU6NG 128 MB at 700 MHz (T33VN/ZN): APLL 891
	  / MPLL 1400.

config T33_DDR3
	bool
	default y if T33_DDR3_W631_900 || T33_DDR3_W631_700
	help
	  Master "this build is DDR3" switch (vs DDR2). Selects the
	  hardware-train Innophy path + DDR3 ddrc_init register
	  branches + DDR3 drive/ODT defaults + the W631GU6NG pin
	  MAP in t33/sdram.c. DDR2 builds use the soft-train path.

config SPL_T33_USB_BOOT
	bool "T33 SPL: return to mask ROM for USB boot (dev loop)"
	depends on SPL
	help
	  Build the SPL as a mask-ROM USB-boot stage1: bring up the
	  clocks (and DDR once ported), then return to the bootrom
	  (jr ra) instead of loading U-Boot proper from SPI-NOR -
	  how the SPL is brought up and tested (QEMU / lab rig).
	  Development only.

endif
```

## arch/mips/mach-xburst/t40/Kconfig
```kconfig
# SPDX-License-Identifier: GPL-2.0+

if SOC_T40

choice
	prompt "T40 SoC variant"
	default T40_VARIANT_T40NN
	help
	  T40 product variant. The four T40 SKUs per vendor
	  include/configs/isvp_common.h:
	    T40A  - DDR3 32-bit dual-rank 1 GiB (M15T4G16256A_2S)
	    T40N  - DDR2 32-bit       128 MiB (M14D5121632A)
	    T40NN - DDR2 32-bit       128 MiB (M14D5121632A, cloner setpoint)
	    T40XP - DDR3 32-bit       256 MiB (M15T1G1664A_2C)
	  DDR parameters per variant come from the vendor U-Boot
	  `tools/ingenic-tools/ddr_params_creator` host-tool output for
	  the specific chip + freq + bus configuration. Vendor does not
	  ship a separate T40NN target - mainline keeps T40NN distinct
	  to preserve the cloner-derived 500 MHz DDR2 timings that the
	  lab T40 board (silkscreen "T40NN") boots cleanly on.

config T40_VARIANT_T40A
	bool "T40A (DDR3-1333, 1 GiB dual-rank, 32-bit) [untested]"
	help
	  T40A: DDR3 32-bit dual-rank M15T4G16256A_2S (1 GiB total per
	  ddr_params_creator; vendor isvp_common.h tags as
	  CONFIG_DDR_128M for SoC addressing). APLL 1008 MHz, MPLL 1400
	  MHz (DDR=700 MHz). Values are direct ddr_params_creator output
	  from isvp_t40a_sfcnor; not yet validated in mainline (no T40A
	  hardware in the lab).

config T40_VARIANT_T40N
	bool "T40N (DDR2-1100, 128 MiB, 32-bit) [untested]"
	help
	  T40N: DDR2 32-bit 128 MiB M14D5121632A. APLL 912 MHz, MPLL
	  1100 MHz (DDR=550 MHz), per vendor isvp_common.h CONFIG_T40N /
	  DDR_550M block. Values are direct ddr_params_creator output
	  from isvp_t40n_sfcnor; not yet validated in mainline at the
	  vendor 550 MHz target. For the conservative 500 MHz cloner
	  timings that the lab T40 board boots on, select T40NN.

config T40_VARIANT_T40NN
	bool "T40NN (DDR2-1000, 128 MiB, 32-bit) [HW-validated]"
	help
	  T40NN: DDR2 32-bit 128 MiB M14D5121632A. APLL 912 MHz, MPLL
	  1000 MHz (DDR=500 MHz), cloner-derived from
	  thingino-cloner/firmwares/t40. The conservative setpoint vs
	  the vendor T40N 550 MHz; the cloner underclocks for margin and
	  this is the setpoint that boots cleanly on the lab T40 board
	  (silkscreen "T40NN"). HW-validated. Vendor isvp_common.h has
	  no separate T40NN target - it groups this silicon under
	  CONFIG_T40N at the higher vendor 550 MHz clock.

config T40_VARIANT_T40XP
	bool "T40XP (DDR3-1200, 256 MiB, 32-bit) [HW-validated]"
	help
	  T40XP: DDR3 32-bit 256 MiB M15T1G1664A_2C. APLL 1008 MHz,
	  MPLL 1200 MHz (DDR=600 MHz). Cloner-derived (vendor
	  isvp_common.h CONFIG_T40XP block targets MPLL 1400 MHz / DDR
	  700 MHz; mainline runs the conservative cloner value until the
	  vendor 700 MHz timings are validated). HW-validated.

endchoice

config T40_DRAM_SIZE_MB
	int
	default 128 if T40_VARIANT_T40A
	default 128 if T40_VARIANT_T40N
	default 128 if T40_VARIANT_T40NN
	default 256 if T40_VARIANT_T40XP

config SPL_T40_USB_BOOT
	bool "T40 SPL: return to mask ROM for USB boot (dev loop)"
	depends on SPL
	help
	  Build the SPL as a mask-ROM USB-boot stage1: bring up the
	  PLLs and DDR, then return to the bootrom (jr ra) instead of
	  loading U-Boot proper from SPI-NOR. The mask ROM then uploads
	  U-Boot proper over USB. Used by the USB-boot / DFU loader
	  defconfigs (isvp_t40n_usbboot_defconfig,
	  isvp_t40xp_usbboot_defconfig).

config SPL_T40_SFC_NAND_BOOT
	bool "T40 SPL: load U-Boot proper from SPI-NAND via SFC"
	depends on SPL && !SPL_T40_USB_BOOT
	help
	  Build the SPL as a cold-boot stage1 that probes the SPI-NAND
	  on SFC, reads U-Boot proper out of the NAND at a fixed offset
	  (T40_NAND_UBOOT_OFFSET, default 128 KiB), and jumps. Used by
	  the production T40XP SFCNAND defconfig
	  (isvp_t40xp_sfcnand_defconfig). The driver lives in
	  arch/mips/mach-xburst/t40/sfc_nand.c.

config SPL_T40_NAND_PROBE
	bool "T40 SPL: probe SPI-NAND and print chip ID (USB-boot debug)"
	depends on SPL && SPL_T40_USB_BOOT
	help
	  Diagnostic: link the SFC SPI-NAND probe into the USB-boot SPL
	  and call sfc_nand_init() just before returning to mask ROM.
	  Lets us validate the NAND read path on real silicon without
	  having to commit a flash layout for U-Boot in NAND first. The
	  SPL still returns to mask ROM after the probe, so U-Boot is
	  uploaded over USB exactly as in the plain USB-boot defconfig.

endif
```

## arch/mips/mach-xburst/t41/Kconfig
```kconfig
# SPDX-License-Identifier: GPL-2.0+

if SOC_T41

# The T41 SKU (DDR type/geometry/clocks) is selected at runtime from the
# devicetree: each leaf .dts sets a per-SKU compatible on &ddr and the
# drivers/ram/ingenic/ddr_innophy driver carries the setpoints in its
# of_match .data (same model as T31/T40/A1). No Kconfig variant.

config SPL_T41_USB_BOOT
	bool "T41 SPL: return to mask ROM for USB boot (dev loop)"
	depends on SPL
	help
	  Build the SPL as a mask-ROM USB-boot stage1: bring up the
	  PLLs and DDR, then return to the bootrom (jr ra) instead of
	  loading U-Boot proper from SPI-NOR. The mask ROM then uploads
	  U-Boot proper over USB. Used by the USB-boot / DFU loader
	  defconfigs (isvp_t41_usbboot_defconfig and
	  isvp_t41_usbboot_ddr3_defconfig).

endif
```

## board/ingenic/isvp-a1/Kconfig
```kconfig
if TARGET_ISVP_A1

config SYS_BOARD
	default "isvp-a1"

config SYS_VENDOR
	default "ingenic"

config SYS_CONFIG_NAME
	default "isvp-a1"

config TEXT_BASE
	default 0x80100000

endif
```

## board/ingenic/isvp-t21/Kconfig
```kconfig
if TARGET_ISVP_T21

config SYS_BOARD
	default "isvp-t21"

config SYS_VENDOR
	default "ingenic"

config SYS_CONFIG_NAME
	default "isvp-t21"

config TEXT_BASE
	default 0x80100000

endif
```

## board/ingenic/isvp-t23/Kconfig
```kconfig
if TARGET_ISVP_T23

config SYS_BOARD
	default "isvp-t23"

config SYS_VENDOR
	default "ingenic"

config SYS_CONFIG_NAME
	default "isvp-t23"

config TEXT_BASE
	default 0x80100000

endif
```

## board/ingenic/isvp-t30/Kconfig
```kconfig
if TARGET_ISVP_T30

config SYS_BOARD
	default "isvp-t30"

config SYS_VENDOR
	default "ingenic"

config SYS_CONFIG_NAME
	default "isvp-t30"

config TEXT_BASE
	default 0x80100000

endif
```

## board/ingenic/isvp-t31/Kconfig
```kconfig
if TARGET_ISVP_T31

config SYS_BOARD
	default "isvp-t31"

config SYS_VENDOR
	default "ingenic"

config SYS_CONFIG_NAME
	default "isvp-t31"

config TEXT_BASE
	default 0x80100000

endif
```

## board/ingenic/isvp-t33/Kconfig
```kconfig
if TARGET_ISVP_T33

config SYS_BOARD
	default "isvp-t33"

config SYS_VENDOR
	default "ingenic"

config SYS_CONFIG_NAME
	default "isvp-t33"

config TEXT_BASE
	default 0x80100000

endif
```

## board/ingenic/isvp-t40/Kconfig
```kconfig
if TARGET_ISVP_T40

config SYS_BOARD
	default "isvp-t40"

config SYS_VENDOR
	default "ingenic"

config SYS_CONFIG_NAME
	default "isvp-t40"

config TEXT_BASE
	default 0x80100000

endif
```

## board/ingenic/isvp-t41/Kconfig
```kconfig
if TARGET_ISVP_T41

config SYS_BOARD
	default "isvp-t41"

config SYS_VENDOR
	default "ingenic"

config SYS_CONFIG_NAME
	default "isvp-t41"

config TEXT_BASE
	default 0x80100000

endif
```

## configs/isvp_a1_sfcnor_defconfig
```kconfig
CONFIG_MIPS=y
CONFIG_SKIP_LOWLEVEL_INIT=y
CONFIG_SYS_MALLOC_LEN=0x2000000
CONFIG_SPL_LIBCOMMON_SUPPORT=y
CONFIG_SPL_LIBGENERIC_SUPPORT=y
CONFIG_NR_DRAM_BANKS=1
CONFIG_ENV_SIZE=0x10000
CONFIG_ENV_OFFSET=0x50000
CONFIG_ENV_SECT_SIZE=0x10000
CONFIG_DM_GPIO=y
CONFIG_SPL_DM_SPI=y
CONFIG_DEFAULT_DEVICE_TREE="a1n-isvp"
CONFIG_SPL_SYS_MALLOC_F_LEN=0x4000
CONFIG_SPL_SERIAL=y
CONFIG_SPL_STACK=0x80018000
CONFIG_SPL_TEXT_BASE=0x80001000
CONFIG_SPL_BSS_START_ADDR=0x80012000
CONFIG_SPL_BSS_MAX_SIZE=0x2000
CONFIG_SYS_BOOTM_LEN=0x2000000
CONFIG_SYS_LOAD_ADDR=0x80600000
CONFIG_SPL=y
CONFIG_SPL_SPI_FLASH_SUPPORT=y
CONFIG_SPL_SPI=y
CONFIG_ARCH_XBURST=y
CONFIG_SOC_A1=y
CONFIG_TARGET_ISVP_A1=y
CONFIG_BUILD_TARGET="u-boot-lzma.img"
CONFIG_SYS_MIPS_TIMER_FREQ=1104000000
CONFIG_DISPLAY_CPUINFO=y
CONFIG_BOARD_INIT=y
CONFIG_SPL_MAX_SIZE=0x13000
# CONFIG_SPL_SHARES_INIT_SP_ADDR is not set
CONFIG_SPL_HAVE_INIT_STACK=y
CONFIG_SPL_SYS_MALLOC=y
CONFIG_SPL_HAS_CUSTOM_MALLOC_START=y
CONFIG_SPL_CUSTOM_SYS_MALLOC_ADDR=0x80800000
CONFIG_SPL_SYS_MALLOC_SIZE=0x400000
CONFIG_SPL_DM_SPI_FLASH=y
CONFIG_SPL_SPI_LOAD=y
CONFIG_SYS_SPI_U_BOOT_OFFS=0x14000
CONFIG_HUSH_PARSER=y
CONFIG_CMD_GPIO=y
CONFIG_BUTTON=y
CONFIG_BUTTON_GPIO=y
CONFIG_BUTTON_CMD=y
CONFIG_CMD_PART=y
CONFIG_CMD_USB=y
CONFIG_CMD_DHCP=y
CONFIG_CMD_MII=y
CONFIG_CMD_NFS=y
CONFIG_CMD_PING=y
CONFIG_CMD_SOUND=y
CONFIG_CMD_EXT4=y
CONFIG_CMD_FAT=y
CONFIG_CMD_FS_GENERIC=y
# CONFIG_SPL_DOS_PARTITION is not set
CONFIG_EFI_PARTITION=y
# CONFIG_SPL_EFI_PARTITION is not set
CONFIG_SPL_OF_CONTROL=y
CONFIG_OF_SPL_REMOVE_PROPS="pinctrl-names interrupt-parent interrupts"
CONFIG_ENV_IS_IN_SPI_FLASH=y
CONFIG_NET_RANDOM_ETHADDR=y
CONFIG_CLK=y
CONFIG_CLK_INGENIC_A1=y
CONFIG_MTD=y
CONFIG_DM_SPI_FLASH=y
CONFIG_SPI_FLASH_SFDP_SUPPORT=y
CONFIG_SPI_FLASH_BOYA=y
CONFIG_SPI_FLASH_DOSILICON=y
CONFIG_SPI_FLASH_EON=y
CONFIG_SPI_FLASH_GALLOP=y
CONFIG_SPI_FLASH_FIDELIX=y
CONFIG_SPI_FLASH_FUDAN=y
CONFIG_SPI_FLASH_GIGADEVICE=y
CONFIG_SPI_FLASH_MACRONIX=y
CONFIG_SPI_FLASH_PUYA=y
CONFIG_SPI_FLASH_WINBOND=y
CONFIG_SPI_FLASH_XMC=y
CONFIG_SPI_FLASH_XTX=y
CONFIG_SPI_FLASH_ZBIT=y
CONFIG_DWC_ETH_XGMAC_INGENIC=y
CONFIG_PINCTRL=y
CONFIG_PINCTRL_INGENIC=y
CONFIG_RAM=y
CONFIG_RAM_INGENIC_DDR_INNOPHY=y
CONFIG_DM_SERIAL=y
CONFIG_SYS_NS16550=y
CONFIG_SOUND=y
CONFIG_I2S=y
CONFIG_I2S_INGENIC=y
CONFIG_SPI=y
CONFIG_DM_SPI=y
CONFIG_SPI_INGENIC=y
CONFIG_SYSRESET=y
CONFIG_SYSRESET_WATCHDOG=y
CONFIG_SYSRESET_WATCHDOG_AUTO=y
CONFIG_USB=y
# CONFIG_SPL_DM_USB is not set
CONFIG_USB_DWC2=y
CONFIG_USB_HOST_ETHER=y
CONFIG_USB_ETHER_ASIX=y
CONFIG_USB_ETHER_ASIX88179=y
CONFIG_USB_ETHER_MCS7830=y
CONFIG_USB_ETHER_RTL8152=y
CONFIG_USB_ETHER_SMSC95XX=y
# CONFIG_WATCHDOG_AUTOSTART is not set
CONFIG_WDT_INGENIC=y
CONFIG_FAT_WRITE=y
# CONFIG_BINMAN_FDT is not set
CONFIG_LZMA=y
CONFIG_SPL_LZMA=y
```

## configs/isvp_a1_usbboot_defconfig
```kconfig
CONFIG_MIPS=y
CONFIG_SKIP_LOWLEVEL_INIT=y
CONFIG_SYS_MALLOC_LEN=0x2000000
CONFIG_SPL_LIBCOMMON_SUPPORT=y
CONFIG_SPL_LIBGENERIC_SUPPORT=y
CONFIG_NR_DRAM_BANKS=1
CONFIG_DM_GPIO=y
CONFIG_DEFAULT_DEVICE_TREE="a1n-isvp-dfu"
CONFIG_SPL_SERIAL=y
CONFIG_SPL_STACK=0x80018000
CONFIG_SPL_TEXT_BASE=0x80001000
CONFIG_SPL_BSS_START_ADDR=0x80012000
CONFIG_SPL_BSS_MAX_SIZE=0x2000
CONFIG_SYS_BOOTM_LEN=0x2000000
CONFIG_SYS_LOAD_ADDR=0x80600000
CONFIG_SPL=y
CONFIG_ARCH_XBURST=y
CONFIG_SOC_A1=y
CONFIG_SPL_A1_USB_BOOT=y
CONFIG_TARGET_ISVP_A1=y
CONFIG_BUILD_TARGET="u-boot-lzma.img"
CONFIG_SYS_MIPS_TIMER_FREQ=1104000000
CONFIG_BOOTDELAY=1
CONFIG_USE_BOOTCOMMAND=y
CONFIG_BOOTCOMMAND="dfu 0 sf 0:0"
CONFIG_USE_PREBOOT=y
CONFIG_PREBOOT="sf probe"
CONFIG_DISPLAY_CPUINFO=y
CONFIG_BOARD_INIT=y
CONFIG_SPL_MAX_SIZE=0x13000
# CONFIG_SPL_SHARES_INIT_SP_ADDR is not set
CONFIG_SPL_HAVE_INIT_STACK=y
CONFIG_SPL_SYS_MALLOC=y
CONFIG_CMD_DFU=y
CONFIG_CMD_GPIO=y
CONFIG_CMD_PART=y
CONFIG_CMD_SPI=y
CONFIG_CMD_USB=y
CONFIG_CMD_USB_MASS_STORAGE=y
CONFIG_CMD_DHCP=y
CONFIG_CMD_PING=y
CONFIG_CMD_EXT4=y
CONFIG_CMD_FAT=y
CONFIG_CMD_FS_GENERIC=y
# CONFIG_SPL_DOS_PARTITION is not set
CONFIG_EFI_PARTITION=y
# CONFIG_SPL_EFI_PARTITION is not set
CONFIG_SPL_OF_CONTROL=y
CONFIG_NET_RANDOM_ETHADDR=y
CONFIG_CLK=y
CONFIG_CLK_INGENIC_A1=y
CONFIG_DFU_RAM=y
CONFIG_DFU_SF=y
CONFIG_SET_DFU_ALT_INFO=y
CONFIG_MTD=y
CONFIG_DM_SPI_FLASH=y
CONFIG_SPI_FLASH_SFDP_SUPPORT=y
CONFIG_SPI_FLASH_BOYA=y
CONFIG_SPI_FLASH_DOSILICON=y
CONFIG_SPI_FLASH_EON=y
CONFIG_SPI_FLASH_GALLOP=y
CONFIG_SPI_FLASH_FIDELIX=y
CONFIG_SPI_FLASH_FUDAN=y
CONFIG_SPI_FLASH_GIGADEVICE=y
CONFIG_SPI_FLASH_MACRONIX=y
CONFIG_SPI_FLASH_PUYA=y
CONFIG_SPI_FLASH_WINBOND=y
CONFIG_SPI_FLASH_XMC=y
CONFIG_SPI_FLASH_XTX=y
CONFIG_SPI_FLASH_ZBIT=y
CONFIG_PINCTRL=y
CONFIG_PINCTRL_INGENIC=y
CONFIG_RAM=y
CONFIG_RAM_INGENIC_DDR_INNOPHY=y
CONFIG_DM_SERIAL=y
CONFIG_SYS_NS16550=y
CONFIG_SPI=y
CONFIG_DM_SPI=y
CONFIG_SPI_INGENIC=y
CONFIG_SYSRESET=y
CONFIG_SYSRESET_WATCHDOG=y
CONFIG_SYSRESET_WATCHDOG_AUTO=y
CONFIG_USB=y
# CONFIG_SPL_DM_USB is not set
CONFIG_DM_USB_GADGET=y
CONFIG_USB_DWC2=y
CONFIG_USB_STORAGE=y
CONFIG_USB_GADGET=y
CONFIG_USB_GADGET_MANUFACTURER="Ingenic"
CONFIG_USB_GADGET_VENDOR_NUM=0xa108
CONFIG_USB_GADGET_PRODUCT_NUM=0x4d44
CONFIG_USB_GADGET_DWC2_OTG=y
CONFIG_USB_GADGET_DWC2_OTG_FORCE_DEV_MODE=y
CONFIG_USB_GADGET_DOWNLOAD=y
# CONFIG_WATCHDOG_AUTOSTART is not set
CONFIG_WDT_INGENIC=y
CONFIG_FAT_WRITE=y
# CONFIG_BINMAN_FDT is not set
CONFIG_LZMA=y
CONFIG_SPL_LZMA=y
```
