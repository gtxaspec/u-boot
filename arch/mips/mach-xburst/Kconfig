## arch/mips/mach-xburst/t21/Kconfig
```kconfig
if SOC_T21

choice
	prompt "T21 SoC variant"
	default T21_VARIANT_T21N
	help
	  Specific T21 product variant. T21 is XBurst1/Innophy-DDR2
	  like T23 (same 64 MB DDR2 M14D5121632A, 4-bank) but with a
	  VPLL. Variants differ in the APLL (CPU) clock and the DDR
	  rate: T21N = APLL 864 / DDR 450, HIGH_PERF = APLL 1200 /
	  DDR 500. The CPAPCR M/N/OD encodings are the exact vendor
	  isvp_common.h CONFIG_SYS_APLL_MNOD values (non-uniform, OD0
	  in the [7:5] field - do not recompute, vendor-authoritative).

config T21_VARIANT_HP
	bool "T21 HIGH_PERF (CPU 1200 MHz, DDR 500, 64 MB)"

config T21_VARIANT_T21N
	bool "T21N (CPU 864 MHz, DDR 450, 64 MB)"

endchoice

config T21_VARIANT_NAME
	string
	default "T21-HP" if T21_VARIANT_HP
	default "T21N"

config T21_APLL_MNOD
	hex
	default 0x03100860 if T21_VARIANT_HP
	default 0x04704840
	help
	  CPAPCR value, exact vendor CONFIG_SYS_APLL_MNOD:
	  864 = (M=71,N=1,OD1=1<<11,OD0=2<<5) = 0x04704840 (T21N);
	  1200 = (M=49,N=0,OD1=1<<11,OD0=3<<5) = 0x03100860 (HIGH_PERF).

config SPL_T21_USB_BOOT
	bool "T21 SPL: return to mask ROM for USB boot (dev loop)"
	depends on SPL
	help
	  Build the SPL as a mask-ROM USB-boot stage1: bring up the
	  clocks (and DDR once ported), then return to the bootrom
	  (jr ra) instead of loading U-Boot proper from SPI-NOR -
	  how the SPL is brought up and tested on the lab rig.
	  Development only.

endif
```

## arch/mips/mach-xburst/t23/Kconfig
```kconfig
if SOC_T23

choice
	prompt "T23 SoC variant"
	default T23_VARIANT_T23N
	help
	  Specific T23 product variant. T23 is XBurst1/Innophy-DDR2
	  like T31, but no T23 board is 128 MB: T23/T23N/T23X use the
	  64 MB DDR2 M14D5121632A (4-bank), T23DL/T23DN the 32 MB
	  M14D2561616A. Variants differ in the APLL (CPU) clock and
	  the DRAM part. The CPAPCR M/N/OD encodings below are the
	  exact vendor isvp_common.h CONFIG_SYS_APLL_MNOD values
	  (non-uniform N/OD - do not recompute, the vendor numbers are
	  authoritative).

config T23_VARIANT_T23N
	bool "T23N (CPU 1188 MHz, 64 MB)"

config T23_VARIANT_T23N_HP
	bool "T23N-HP (CPU 1400 MHz, 64 MB)"

config T23_VARIANT_T23N_LP
	bool "T23N-LP (CPU 936 MHz, 64 MB)"

config T23_VARIANT_T23X
	bool "T23X / T23 base (CPU 1000 MHz, 64 MB)"

config T23_VARIANT_T23DL
	bool "T23DL (CPU 1188 MHz, 32 MB)"

config T23_VARIANT_T23DN
	bool "T23DN (CPU 1000 MHz, 32 MB)"

endchoice

config T23_VARIANT_NAME
	string
	default "T23N-HP" if T23_VARIANT_T23N_HP
	default "T23N-LP" if T23_VARIANT_T23N_LP
	default "T23X"    if T23_VARIANT_T23X
	default "T23DL"   if T23_VARIANT_T23DL
	default "T23DN"   if T23_VARIANT_T23DN
	default "T23N"

config T23_DRAM_32M
	bool
	default y if T23_VARIANT_T23DL || T23_VARIANT_T23DN
	help
	  T23DL/T23DN populate the 32 MB DDR2 M14D2561616A (row 13,
	  col 9, 4-bank). All other T23 variants use the 64 MB
	  M14D5121632A (row 13, col 10, 4-bank). Selects the matching
	  DDRC_CFG/MMAP geometry in mach/t23-ddr.h. No 128 MB option:
	  no T23 board ships 128 MB.

config T23_APLL_MNOD
	hex
	default 0x15e0d100 if T23_VARIANT_T23N_HP
	default 0x0ea0d100 if T23_VARIANT_T23N_LP
	default 0x07d05900 if T23_VARIANT_T23X
	default 0x07d05900 if T23_VARIANT_T23DN
	default 0x1290d100 if T23_VARIANT_T23DL
	default 0x1290d100
	help
	  CPAPCR value = (M<<20)|(N<<14)|(OD1<<11)|(OD0<<8), exact
	  vendor CONFIG_SYS_APLL_MNOD: 1400=(350,3,2,1)=0x15e0d100,
	  1188=(297,3,2,1)=0x1290d100, 1000=(125,1,3,1)=0x07d05900,
	  936=(234,3,2,1)=0x0ea0d100. T23DL is vendor-exact (APLL
	  1188 + DDR 600). T23DN's vendor profile is APLL 1000 + DDR
	  500; the shared 600 MHz DDR path is used for it pending a
	  per-variant DDR-clock split (rig device is T23N, so this is
	  not yet HW-exercised).

config SPL_T23_USB_BOOT
	bool "T23 SPL: return to mask ROM for USB boot (dev loop)"
	depends on SPL
	help
	  Build the SPL as a mask-ROM USB-boot stage1: bring up the
	  clocks (and DDR once ported), then return to the bootrom
	  (jr ra) instead of loading U-Boot proper from SPI-NOR. The
	  T23N is bootrom-only on the lab rig, so this is how the SPL
	  is brought up and tested. Development only.

endif
```

## arch/mips/mach-xburst/t30/Kconfig
```kconfig
if SOC_T30

choice
	prompt "T30 SoC variant"
	default T30_VARIANT_T30L
	help
	  Specific T30 product variant. T30 is XBurst1/Innophy-DDR2
	  like T21 (cpm_cpxpcr_t PLL, VPLL) and uses the same 64 MB
	  DDR2 M14D5121632A (4-bank) at DDR 500 MHz; variants differ
	  in the APLL (CPU) clock. The CPAPCR M/N/OD encodings are
	  the exact vendor isvp_common.h CONFIG_SYS_APLL_MNOD values
	  (non-uniform, OD0 in the [7:5] field - do not recompute,
	  vendor-authoritative). T30A (APLL 1200 / DDR 600 / 128 MB
	  DDR2) is a future variant - not in this 64 MB choice.

config T30_VARIANT_T30L
	bool "T30L / lite (CPU 750 MHz, DDR 500, 64 MB)"

config T30_VARIANT_T30N
	bool "T30N (CPU 900 MHz, DDR 500, 64 MB)"

endchoice

config T30_VARIANT_NAME
	string
	default "T30N" if T30_VARIANT_T30N
	default "T30L"

config T30_APLL_MNOD
	hex
	default 0x04a04840 if T30_VARIANT_T30N
	default 0x07c05040
	help
	  CPAPCR value, exact vendor CONFIG_SYS_APLL_MNOD:
	  750 = (M=124,N=1,OD1=2<<11,OD0=2<<5) = 0x07c05040 (T30L);
	  900 = (M=74,N=1,OD1=1<<11,OD0=2<<5)  = 0x04a04840 (T30N).

config SPL_T30_USB_BOOT
	bool "T30 SPL: return to mask ROM for USB boot (dev loop)"
	depends on SPL
	help
	  Build the SPL as a mask-ROM USB-boot stage1: bring up the
	  clocks (and DDR once ported), then return to the bootrom
	  (jr ra) instead of loading U-Boot proper from SPI-NOR -
	  how the SPL is brought up and tested on the lab rig.
	  Development only.

endif
```

## arch/mips/mach-xburst/t31/Kconfig
```kconfig
if SOC_T31

choice
	prompt "T31 SoC variant"
	default T31_VARIANT_T31X
	help
	  Specific T31 product variant. All share the MPLL/VPLL and the
	  Innophy PHY and differ in the APLL (CPU) clock and the DRAM
	  part: T31N/T31L/T31LC populate 64 MB DDR2 (M14D5121632A,
	  4-bank); T31X/T31AL populate 128 MB DDR2 (M14D1G1664A,
	  8-bank); T31A and C100 populate 128 MB DDR3 (M15T1G1664A,
	  8-bank, hardware write-leveling). Each is a distinct entry
	  so the exact SKU is identified at boot.

config T31_VARIANT_C100
	bool "C100 (DDR3-128M, CPU 1392 MHz)"

config T31_VARIANT_T31A
	bool "T31A (DDR3-128M, CPU 1512 MHz)"
	help
	  T31A populates 128 MB DDR3 M15T1G1664A and uses the legacy
	  Innophy DDR3 controller/PHY init path (DFI reset, the DDR3
	  LMR MRS sequence and hardware write-leveling) instead of the
	  DDR2 soft path. Selects CONFIG_T31_DDR3.

config T31_VARIANT_T31AL
	bool "T31AL (DDR2-128M, CPU 1392 MHz)"

config T31_VARIANT_T31L
	bool "T31L (DDR2-64M, CPU 1008 MHz, lite)"

config T31_VARIANT_T31LC
	bool "T31LC (DDR2-64M, CPU 1104 MHz, lite)"

config T31_VARIANT_T31N
	bool "T31N (DDR2-64M, CPU 1392 MHz)"
	help
	  Nominal 1400 MHz; the PLL aligns it to 1392 exactly as the
	  vendor get_pllreg_value() does.

config T31_VARIANT_T31X
	bool "T31X (DDR2-128M, CPU 1392 MHz)"

endchoice

config T31_VARIANT_NAME
	string
	default "C100"  if T31_VARIANT_C100
	default "T31A"  if T31_VARIANT_T31A
	default "T31AL" if T31_VARIANT_T31AL
	default "T31L"  if T31_VARIANT_T31L
	default "T31LC" if T31_VARIANT_T31LC
	default "T31N"  if T31_VARIANT_T31N
	default "T31X"  if T31_VARIANT_T31X

config T31_DRAM_128M
	bool
	default y if T31_VARIANT_T31X || T31_VARIANT_T31AL || \
		     T31_VARIANT_T31A || T31_VARIANT_C100
	help
	  T31X/T31AL populate the 128 MB DDR2 M14D1G1664A (8-bank);
	  T31A/C100 the 128 MB DDR3 M15T1G1664A (8-bank); T31N/T31L/
	  T31LC the 64 MB DDR2 M14D5121632A (4-bank). Selects the
	  matching DDRC_CFG/MMAP geometry, the 8-bank flag and the
	  chip size in mach/t31-ddr.h (the 128 MB DDR2 and DDR3 parts
	  share row/col/bank/size).

config T31_DDR3
	bool
	default y if T31_VARIANT_T31A || T31_VARIANT_C100
	help
	  T31A and C100 are DDR3 M15T1G1664A (128 MB). Selects the
	  DDR3 controller/PHY parameter set (mach/t31-ddr.h: DDRC_CFG
	  /REFCNT/TIMING1-6/MR0, the DDR3-@600 set from isvp_c100)
	  and the legacy Innophy DDR3 init branches in t31/sdram.c
	  (INNO_MEM_CFG=0x30, DFI reset, the no-poll DDR3 LMR MRS
	  sequence and hardware write-leveling) instead of the DDR2
	  soft path. Geometry is shared via T31_DRAM_128M. The DDR
	  clock is MPLL/2 (T31_MPLL_MHZ): T31A 750, C100 600. APLL
	  differs too (T31A 1512, C100 1392, via T31_APLL_MHZ).

config T31_APLL_MHZ
	int
	default 1512 if T31_VARIANT_T31A
	default 1416 if T31_VARIANT_T31N
	default 1008 if T31_VARIANT_T31L
	default 1104 if T31_VARIANT_T31LC
	default 1392
	help
	  APLL (CPU PLL) target in MHz for the selected variant.
	  These are the post-alignment values the vendor
	  get_pllreg_value() actually programs (it aligns the
	  nominal freq to a 24 MHz multiple): T31N nominal 1404 ->
	  1416 (M=118); T31A nominal 1500 -> 1512 (M=126); LC 1104;
	  L 1008; X/AL/C100 1392. The SPL programs CPAPCR
	  M = T31_APLL_MHZ / 12 (N=1, OD0=1, OD1=2); the value must
	  be a multiple of 12 and keep Fvco = 24*M in 1250-5000 MHz.

config T31_MPLL_MHZ
	int
	default 1512 if T31_VARIANT_T31A
	default 1008 if T31_VARIANT_T31N || T31_VARIANT_T31L || \
			T31_VARIANT_T31LC
	default 1200
	help
	  MPLL target in MHz (post-alignment, what vendor
	  get_pllreg_value() programs) for the selected variant.
	  MPLL feeds the DDR clock (DDR = MPLL/2) and the H0/H2/PCLK
	  bus tree:
	    1008 -> DDR 504 : T31N/T31L/T31LC (DDR2-64M; vendor
	            "1000" aligned to 1008, M=84)
	    1200 -> DDR 600 : T31X/T31AL (DDR2-128M), C100 (DDR3)
	    1512 -> DDR 756 : T31A (DDR3; vendor "1500" aligned to
	            1512, M=126 - DDR3 params are the nominal-750
	            set, exactly as the vendor runs them at 756)
	  The SPL programs CPMPCR M = T31_MPLL_MHZ / 12 (N=1, OD0=1,
	  OD1=2); must be a multiple of 12 (1008/1200/1512 -> M
	  84/100/126). The 1008 group uses the vendor DDR_500M CPCCR
	  bus dividers (PCLK 8 / H2 4 / H0 4); 1200/1512 share PCLK
	  12 / H2 6 / H0 6 (t31/pll.c picks per band).

config SPL_T31_USB_BOOT
	bool "T31 SPL: return to mask ROM for USB boot (dev loop)"
	depends on SPL
	help
	  Build the SPL as a mask-ROM USB-boot stage1: bring up the
	  clocks and DDR, then return to the bootrom (jr ra) instead of
	  loading U-Boot proper from SPI-NOR. The host then uploads
	  U-Boot straight into DRAM over USB (VR_PROGRAM_START2), so a
	  build can be booted without touching the NOR flash. For
	  development only; the production image uses the SFC-NOR SPL.

config SYS_SOC
	default "t31"

config SYS_DCACHE_SIZE
	default 32768

config SYS_ICACHE_SIZE
	default 32768

config SYS_DCACHE_LINE_SIZE
	default 32

config SYS_ICACHE_LINE_SIZE
	default 32

endif
```

## arch/mips/mach-xburst/t32/Kconfig
```kconfig
if SOC_T32

choice
	prompt "T32 SoC variant"
	default T32_VARIANT_LQ
	help
	  Specific T32 (vendor PRJ007) goat SKU. Authoritative params
	  are the host pll_params_creator / ddr_creator_chip_v3 output
	  for PRJ007_<sku>_goat_sfcnor (verbatim, NOT recomputed):
	    LQ/VL/ZL  DDR2  M14D5121632A  64 MB  DDR 600
	    NQ        DDR3  W631GU6NG    128 MB  DDR 900
	    VN/ZN     DDR3  W631GU6NG    128 MB  DDR 700
	    XQ        DDR3  W632GU6NG    256 MB  DDR 900
	    VX/ZX     DDR3  W632GU6NG    256 MB  DDR 700
	    VNP       LPDDR3 W63AH6N2B  128 MB  DDR 700
	  LQ==VL==ZL, VN==ZN, VX==ZX are param-identical vendor bin
	  badges. DDR2 = soft-train; DDR3/LPDDR3 = hardware-train (a
	  different Innophy PHY path).

config T32_VARIANT_LQ
	bool "T32LQ (DDR2 600 MHz, 64 MB)"

config T32_VARIANT_VL
	bool "T32VL (DDR2 600 MHz; == LQ params)"

config T32_VARIANT_ZL
	bool "T32ZL (DDR2 600 MHz; == LQ params)"

config T32_VARIANT_NQ
	bool "T32NQ (DDR3 900 MHz, 128 MB)"

config T32_VARIANT_VN
	bool "T32VN (DDR3 700 MHz, 128 MB)"

config T32_VARIANT_ZN
	bool "T32ZN (DDR3 700 MHz; == VN params)"

config T32_VARIANT_XQ
	bool "T32XQ (DDR3 900 MHz, 256 MB)"

config T32_VARIANT_VX
	bool "T32VX (DDR3 700 MHz, 256 MB)"

config T32_VARIANT_ZX
	bool "T32ZX (DDR3 700 MHz, 256 MB; == VX params)"

config T32_VARIANT_VNP
	bool "T32VNP (LPDDR3 700 MHz, 128 MB)"

endchoice

config T32_VARIANT_NAME
	string
	default "T32VL"  if T32_VARIANT_VL
	default "T32ZL"  if T32_VARIANT_ZL
	default "T32NQ"  if T32_VARIANT_NQ
	default "T32VN"  if T32_VARIANT_VN
	default "T32ZN"  if T32_VARIANT_ZN
	default "T32XQ"  if T32_VARIANT_XQ
	default "T32VX"  if T32_VARIANT_VX
	default "T32ZX"  if T32_VARIANT_ZX
	default "T32VNP" if T32_VARIANT_VNP
	default "T32LQ"

# --- internal DDR param-class selectors (one set per variant) ---
# mach/t32-ddr.h param chain + t32/pll.c key off these.

config T32_DDR3_W631_900
	bool
	default y if T32_VARIANT_NQ

config T32_DDR3_W631_700
	bool
	default y if T32_VARIANT_VN || T32_VARIANT_ZN

config T32_DDR3_W632_900
	bool
	default y if T32_VARIANT_XQ

config T32_DDR3_W632_700
	bool
	default y if T32_VARIANT_VX || T32_VARIANT_ZX

config T32_LPDDR3_700
	bool
	default y if T32_VARIANT_VNP

config T32_DDR3
	bool
	default y if T32_DDR3_W631_900 || T32_DDR3_W631_700 || \
		     T32_DDR3_W632_900 || T32_DDR3_W632_700
	help
	  Master "this build is DDR3". Selects the hardware-train
	  Innophy path + DDR3 ddrc_init register branches + DDR3
	  drive/ODT defaults in t32/sdram.c.

config T32_LPDDR3
	bool
	default y if T32_LPDDR3_700
	help
	  Master "this build is LPDDR3". Hardware-train path with
	  the LPDDR3 ddrc_init branches (INIT3 as-is, INIT4 masked,
	  TIMING6/14 instead of TIMING8, LPDDR3 write-leveling).

config T32_HWTRAIN
	bool
	default y if T32_DDR3 || T32_LPDDR3
	help
	  DDR3 and LPDDR3 both use the Innophy hardware-train path
	  (write-leveling -> calibration -> read/write training)
	  instead of the DDR2 soft-train. Single gate for that.

config SPL_T32_USB_BOOT
	bool "T32 SPL: return to mask ROM for USB boot (dev loop)"
	depends on SPL
	help
	  Build the SPL as a mask-ROM USB-boot stage1: bring up the
	  clocks (and DDR once ported), then return to the bootrom
	  (jr ra) instead of loading U-Boot proper from SPI-NOR -
	  how the SPL is brought up and tested (QEMU / lab rig).
	  Development only.

endif
```
