## arch/mips/mach-xburst/Kconfig
```kconfig
menu "Ingenic XBurst T-series platforms"
	depends on ARCH_XBURST

#
# XBurst1 T-series boot shape is dictated by one hardware fact: the
# mask-ROM SPI-NOR load cap. Two ROM generations exist in the family:
#
#   Capped (0x6800 = 26 KiB) - T10/T20/T21/T30. The gen-1/1.5 ROM loads
#     only the first 0x6800 bytes of the boot image, too small for the
#     DM SFC + spi-nor framework (~29 KiB on its own). These parts run a
#     tiny DDR-only TPL (cache-as-RAM) that brings up PLL + DRAM and
#     chain-loads a DRAM-resident SPL over a minimal 0x03 NOR read; the
#     full SPI framework then lives in that SPL. They select SUPPORT_TPL.
#
#   Uncapped - T23/T31. The later ROM loads the whole image, so these
#     keep a single big DM SPL (SPL_SPI) and need no TPL or hand-rolled
#     read.
#
# Either way the only per-SoC difference is DDR: the Innophy PHY
# (drivers/ram/ingenic/ddr_t31.c; T21/T23/T30/T31) or the Synopsys DWC
# PHY (ddr_t20.c; T10/T20), with the per-SKU register block supplied as
# the "ingenic,sdram-params" devicetree array. Everything below the
# bring-up shim is one shared codebase.
#
# This follows established U-Boot patterns: DDR-in-TPL via OF_PLATDATA
# (Rockchip rk3328) on a MIPS tpl/spl split (MediaTek mt7621). Bindings:
# doc/device-tree-bindings/memory-controllers/ingenic,t31-ddr-innophy.yaml
# and ingenic,t20-ddr-dwc.yaml.
#

config SYS_VENDOR
	default "ingenic"

config SYS_SOC
	default "a1" if SOC_A1
	default "t10" if SOC_T10
	default "t20" if SOC_T20
	default "t21" if SOC_T21
	default "t23" if SOC_T23
	default "t30" if SOC_T30
	default "t31" if SOC_T31
	default "t32" if SOC_T32
	default "t33" if SOC_T33
	default "t40" if SOC_T40
	default "t41" if SOC_T41

choice
	prompt "Ingenic SoC select"
	default SOC_T31

config SOC_A1
	bool "Ingenic A1 (XBurst2)"
	select SUPPORT_LITTLE_ENDIAN
	select SUPPORTS_CPU_MIPS32_R1
	select SUPPORTS_CPU_MIPS32_R2
	select SYS_CACHE_SHIFT_5
	select SYS_MIPS_CACHE_INIT_RAM_LOAD
	select MIPS_L2_CACHE
	select BINMAN
	help
	  Ingenic A1 XBurst2 dual-core camera SoC: 24 MHz EXTAL,
	  APLL/MPLL/VPLL/EPLL, Innophy DDR3, SFC SPI-flash boot via
	  on-chip mask ROM. Variants: A1N (DDR3-800 256M 16-bit),
	  A1NT (DDR3-700), A1X (DDR3-700), A1L (DDR3-800 16-bit),
	  A1A (DDR3-800 APLL 1200).

config SOC_T10
	bool "Ingenic T10"
	select SUPPORT_LITTLE_ENDIAN
	select SUPPORTS_CPU_MIPS32_R1
	select SUPPORTS_CPU_MIPS32_R2
	select SYS_CACHE_SHIFT_5
	select SYS_MIPS_CACHE_INIT_RAM_LOAD
	select BINMAN
	select SUPPORT_TPL
	help
	  Ingenic T10 XBurst1 camera SoC: 24 MHz EXTAL, APLL/MPLL/VPLL,
	  DesignWare (DWC) DDR2 PHY (same family as T20), 64 MB
	  M14D5121632A, SFC SPI-flash boot via on-chip mask ROM. Same
	  XBurst1 base as T20; DWC DDR (not Innophy); 4 GPIO banks;
	  T10N APLL 860 / MPLL 1200 / DDR 400 (MEM_FREQ = MPLL/3).

config SOC_T20
	bool "Ingenic T20"
	select SUPPORT_LITTLE_ENDIAN
	select SUPPORTS_CPU_MIPS32_R1
	select SUPPORTS_CPU_MIPS32_R2
	select SYS_CACHE_SHIFT_5
	select SYS_MIPS_CACHE_INIT_RAM_LOAD
	select BINMAN
	select SUPPORT_TPL
	help
	  Ingenic T20 XBurst1 camera SoC: 24 MHz EXTAL, APLL/MPLL/VPLL,
	  DesignWare (DWC) DDR2 PHY, 64 MB M14D5121632A, SFC SPI-flash
	  boot via on-chip mask ROM. Same XBurst1 base as T31; DWC DDR (not Innophy);
	  3 GPIO banks; T20N APLL 860 / DDR 500.

config SOC_T21
	bool "Ingenic T21"
	select SUPPORT_LITTLE_ENDIAN
	select SUPPORTS_CPU_MIPS32_R1
	select SUPPORTS_CPU_MIPS32_R2
	select SYS_CACHE_SHIFT_5
	select SYS_MIPS_CACHE_INIT_RAM_LOAD
	select BINMAN
	select SUPPORT_TPL
	help
	  Ingenic T21 XBurst1 camera SoC: 24 MHz EXTAL, APLL/MPLL/VPLL,
	  Innophy DDR2 PHY (64 MB M14D5121632A like T23), SFC SPI-flash
	  boot via on-chip mask ROM. Same XBurst1 base as T31/T23;
	  differs in clock targets (APLL 864 / DDR 450).

config SOC_T23
	bool "Ingenic T23"
	select SUPPORT_LITTLE_ENDIAN
	select SUPPORTS_CPU_MIPS32_R1
	select SUPPORTS_CPU_MIPS32_R2
	select SYS_CACHE_SHIFT_5
	select SYS_MIPS_CACHE_INIT_RAM_LOAD
	select BINMAN
	help
	  Ingenic T23 XBurst1 camera SoC: 24 MHz EXTAL, APLL/MPLL (no
	  VPLL), Innophy DDR2 PHY, SFC SPI-flash boot via on-chip mask
	  ROM. Same XBurst1 base as T31; differs in clock targets and
	  the DDR2 part.

config SOC_T30
	bool "Ingenic T30"
	select SUPPORT_LITTLE_ENDIAN
	select SUPPORTS_CPU_MIPS32_R1
	select SUPPORTS_CPU_MIPS32_R2
	select SYS_CACHE_SHIFT_5
	select SYS_MIPS_CACHE_INIT_RAM_LOAD
	select BINMAN
	select SUPPORT_TPL
	help
	  Ingenic T30 XBurst1 camera SoC: 24 MHz EXTAL, APLL/MPLL/VPLL,
	  Innophy DDR2 PHY (64 MB M14D5121632A like T21/T23), SFC SPI-flash
	  boot via on-chip mask ROM. Same XBurst1 base as T31/T23/T21;
	  differs in clock targets (APLL 864 / DDR 500).

config SOC_T31
	bool "Ingenic T31"
	select SUPPORT_LITTLE_ENDIAN
	select SUPPORTS_CPU_MIPS32_R1
	select SUPPORTS_CPU_MIPS32_R2
	select SYS_CACHE_SHIFT_5
	select SYS_MIPS_CACHE_INIT_RAM_LOAD
	select BINMAN
	help
	  Ingenic T31 XBurst1 camera SoC: 24 MHz EXTAL, APLL/MPLL/VPLL,
	  Innophy DDR2/DDR3 PHY, SFC SPI-flash boot via on-chip mask ROM.

config SOC_T32
	bool "Ingenic T32"
	select SUPPORT_LITTLE_ENDIAN
	select SUPPORTS_CPU_MIPS32_R1
	select SUPPORTS_CPU_MIPS32_R2
	select SYS_CACHE_SHIFT_5
	select SYS_MIPS_CACHE_INIT_RAM_LOAD
	select BINMAN
	help
	  Ingenic T32 (vendor PRJ007) XBurst1 "T31-extended" camera SoC:
	  24 MHz EXTAL, APLL/MPLL/VPLL, Innophy DDR (DDR2/DDR3/LPDDR3),
	  SFC2 SPI-flash boot via on-chip mask ROM. Forward-ported from
	  the modern U-Boot 2022.10 vendor branch. Runtime SOCID
	  0x10032004. (DDR2 M14D5121632A is the first supported part.)

config SOC_T33
	bool "Ingenic T33"
	select SUPPORT_LITTLE_ENDIAN
	select SUPPORTS_CPU_MIPS32_R1
	select SUPPORTS_CPU_MIPS32_R2
	select SYS_CACHE_SHIFT_5
	select SYS_MIPS_CACHE_INIT_RAM_LOAD
	select BINMAN
	help
	  Ingenic T33 (vendor PRJ008) XBurst1 "T31-extended" camera SoC:
	  24 MHz EXTAL, APLL/MPLL, Innophy DDR (DDR2/DDR3/LPDDR3), SFC
	  SPI-flash boot via on-chip mask ROM. Forward-ported from the
	  modern U-Boot 2022.10 vendor branch. Runtime SOCID
	  0x10033004. (DDR2 M14D5121632A is the first supported part.)

config SOC_T40
	bool "Ingenic T40"
	select SUPPORT_LITTLE_ENDIAN
	select SUPPORTS_CPU_MIPS32_R1
	select SUPPORTS_CPU_MIPS32_R2
	select SYS_CACHE_SHIFT_5
	select SYS_MIPS_CACHE_INIT_RAM_LOAD
	select MIPS_L2_CACHE
	select BINMAN
	help
	  Ingenic T40 XBurst2 dual-core camera SoC: 24 MHz EXTAL,
	  APLL/MPLL/EPLL/VPLL, Innophy DDR2/DDR3 PHY, SFC SPI-flash
	  boot via on-chip mask ROM. Sibling of A1 (XBurst2); single
	  OTG, Synopsys GMAC, SDHCI-style MSC. Variants: T40 (DDR2
	  64 MB M14D5121632A default), T40N/T40XP (DDR3).

config SOC_T41
	bool "Ingenic T41"
	select SUPPORT_LITTLE_ENDIAN
	select SUPPORTS_CPU_MIPS32_R1
	select SUPPORTS_CPU_MIPS32_R2
	select SYS_CACHE_SHIFT_5
	select SYS_MIPS_CACHE_INIT_RAM_LOAD
	select MIPS_L2_CACHE
	select BINMAN
	help
	  Ingenic T41 XBurst2 dual-core camera SoC: 24 MHz EXTAL,
	  APLL/MPLL/EPLL/VPLL, Innophy DDR3 PHY (16-bit bus on most
	  variants - different from T40XP 32-bit). Same base addresses
	  as T40. Single OTG (DWC2), Synopsys GMAC, SDHCI-style MSC,
	  SFC SPI-flash boot. 13 variants in vendor source. Lab board
	  uses T41NQ: APLL=1104, MPLL=1400 (DDR=700), DDR3-W631GU6NG
	  128 MiB 16-bit, MX25L25645G 32 MiB SPI-NOR boot.

endchoice

source "arch/mips/mach-xburst/a1/Kconfig"
source "arch/mips/mach-xburst/t10/Kconfig"
source "arch/mips/mach-xburst/t20/Kconfig"
source "arch/mips/mach-xburst/t21/Kconfig"
source "arch/mips/mach-xburst/t23/Kconfig"
source "arch/mips/mach-xburst/t30/Kconfig"
source "arch/mips/mach-xburst/t31/Kconfig"
source "arch/mips/mach-xburst/t32/Kconfig"
source "arch/mips/mach-xburst/t33/Kconfig"
source "arch/mips/mach-xburst/t40/Kconfig"
source "arch/mips/mach-xburst/t41/Kconfig"

config XBURST_MAC_FROM_EFUSE
	bool "Derive Ethernet MAC address from the SoC eFUSE serial"
	depends on NET
	select MISC_INIT_R
	help
	  Read the XBurst SoC's per-die eFUSE chip serial and derive a stable,
	  locally-administered "ethaddr" from it when none is set in the
	  environment, instead of generating a fresh random MAC every boot.

	  The derivation matches the one the Ingenic Linux userspace uses, so
	  the bootloader and the running system present the same MAC address.
	  An unfused part falls back to a random MAC.

choice
	prompt "Board select"
	default TARGET_ISVP_T31

config TARGET_ISVP_A1
	bool "Ingenic ISVP-A1 reference board"
	select SOC_A1
	help
	  Ingenic ISVP A1 reference board, DDR3 256 MB, SFC NOR boot.

config TARGET_ISVP_T10
	bool "Ingenic ISVP-T10 reference board"
	select SOC_T10
	help
	  Ingenic ISVP T10 reference board, DDR2 64 MB, SFC NOR boot.

config TARGET_ISVP_T20
	bool "Ingenic ISVP-T20 reference board"
	select SOC_T20
	help
	  Ingenic ISVP T20 reference board, DDR2 64 MB, SFC NOR boot.

config TARGET_ISVP_T21
	bool "Ingenic ISVP-T21 reference board"
	select SOC_T21
	help
	  Ingenic ISVP T21 reference board, DDR2 64 MB, SFC NOR boot.

config TARGET_ISVP_T23
	bool "Ingenic ISVP-T23 reference board"
	select SOC_T23
	help
	  Ingenic ISVP T23 reference board, DDR2 64 MB, SFC NOR boot.

config TARGET_ISVP_T30
	bool "Ingenic ISVP-T30 reference board"
	select SOC_T30
	help
	  Ingenic ISVP T30 reference board, DDR2 64 MB, SFC NOR boot.

config TARGET_ISVP_T31
	bool "Ingenic ISVP-T31 reference board"
	select SOC_T31
	help
	  Ingenic ISVP T31 reference board, DDR2 128 MB, SFC NOR boot.

config TARGET_ISVP_T32
	bool "Ingenic ISVP-T32 reference board"
	select SOC_T32
	help
	  Ingenic ISVP T32 (PRJ007) reference board, DDR2
	  M14D5121632A, SFC NOR boot.

config TARGET_ISVP_T33
	bool "Ingenic ISVP-T33 reference board"
	select SOC_T33
	help
	  Ingenic ISVP T33 (PRJ008) reference board, DDR2
	  M14D5121632A, SFC NOR boot.

config TARGET_ISVP_T40
	bool "Ingenic ISVP-T40 reference board"
	select SOC_T40
	help
	  Ingenic ISVP T40 reference board, DDR2 M14D5121632A,
	  SFC NOR boot.

config TARGET_ISVP_T41
	bool "Ingenic ISVP-T41 reference board"
	select SOC_T41
	help
	  Ingenic ISVP T41 reference board, DDR3 W631GU6NG 16-bit
	  128 MiB, SFC NOR boot (MX25L25645G 32 MiB).

endchoice

source "board/ingenic/isvp-a1/Kconfig"
source "board/ingenic/isvp-t10/Kconfig"
source "board/ingenic/isvp-t20/Kconfig"
source "board/ingenic/isvp-t21/Kconfig"
source "board/ingenic/isvp-t23/Kconfig"
source "board/ingenic/isvp-t30/Kconfig"
source "board/ingenic/isvp-t31/Kconfig"
source "board/ingenic/isvp-t32/Kconfig"
source "board/ingenic/isvp-t33/Kconfig"
source "board/ingenic/isvp-t40/Kconfig"
source "board/ingenic/isvp-t41/Kconfig"

endmenu
```

## arch/mips/mach-xburst/a1/Kconfig
```kconfig
# SPDX-License-Identifier: GPL-2.0+

if SOC_A1

# A1 SoC variant, DDR parameters, DRAM size and PLL setpoints are all
# selected at runtime from the device tree (the per-SKU <sku>-isvp.dts sets
# ingenic,variant on the memory-controller node; the UCLASS_RAM driver and
# pll_init() read it). No compile-time variant Kconfig is needed.

config SPL_A1_USB_BOOT
	bool "A1 SPL: return to mask ROM for USB boot (dev loop)"
	depends on SPL
	help
	  Build the SPL as a mask-ROM USB-boot stage1: bring up the
	  PLLs and DDR, then return to the bootrom (jr ra) instead of
	  loading U-Boot proper from SPI-NOR. The mask ROM then uploads
	  U-Boot proper over USB. Used by the USB-boot / DFU loader
	  defconfig (isvp_a1_usbboot_defconfig). Development only.

endif
```

## arch/mips/mach-xburst/t10/Kconfig
```kconfig
if SOC_T10

choice
	prompt "T10 SoC variant"
	default T10_VARIANT_T10N
	help
	  Specific T10 product variant. T10 is XBurst1 but uses the
	  DesignWare (DWC) DDR2 controller/PHY (vendor ddr_dwc.c),
	  NOT the Innophy core that T21/T23/T30/T31 share - same
	  64 MB DDR2 M14D5121632A part though, at DDR 500 MHz. The
	  PLL is the T31/T23-style M/N/OD1/OD0 (T10 cpm_cpxpcr_t has
	  no PLLRG). Variants differ in the APLL (CPU) clock. The
	  CPAPCR words are the exact vendor isvp_common.h
	  CONFIG_SYS_APLL_MNOD (verbatim, vendor-authoritative).
	  T10X (DDR2 128 MB) is a future variant - not in this
	  64 MB choice.

config T10_VARIANT_T10L
	bool "T10L / lite (CPU 712 MHz, DDR 500, 64 MB)"

config T10_VARIANT_T10N
	bool "T10N (CPU 860 MHz, DDR 500, 64 MB)"

endchoice

config T10_VARIANT_NAME
	string
	default "T10L" if T10_VARIANT_T10L
	default "T10N"

config T10_APLL_MNOD
	hex
	default 0x03b08900 if T10_VARIANT_T10L
	default 0x04708900
	help
	  CPAPCR value, exact vendor CONFIG_SYS_APLL_MNOD (M/N/OD1/
	  OD0, OD0 in [10:8]):
	  860 = (M=71,N=2,OD1=1<<11,OD0=1<<8) = 0x04708900 (T10N);
	  712 = (M=59,N=2,OD1=1<<11,OD0=1<<8) = 0x03b08900 (T10L).

config SPL_T10_USB_BOOT
	bool "T10 SPL: return to mask ROM for USB boot (dev loop)"
	depends on SPL
	help
	  Build the SPL as a mask-ROM USB-boot stage1: bring up the
	  clocks (and DDR once ported), then return to the bootrom
	  (jr ra) instead of loading U-Boot proper from SPI-NOR -
	  how the SPL is brought up and tested on the lab rig.
	  Development only.

endif
```

## arch/mips/mach-xburst/t20/Kconfig
```kconfig
if SOC_T20

choice
	prompt "T20 SoC variant"
	default T20_VARIANT_T20N
	help
	  Specific T20 product variant. T20 is XBurst1 but uses the
	  DesignWare (DWC) DDR2 controller/PHY (vendor ddr_dwc.c),
	  NOT the Innophy core that T21/T23/T30/T31 share - same
	  64 MB DDR2 M14D5121632A part though, at DDR 500 MHz. The
	  PLL is the T31/T23-style M/N/OD1/OD0 (T20 cpm_cpxpcr_t has
	  no PLLRG). Variants differ in the APLL (CPU) clock. The
	  CPAPCR words are the exact vendor isvp_common.h
	  CONFIG_SYS_APLL_MNOD (verbatim, vendor-authoritative).
	  T20N/T20L are 64 MB M14D5121632A; T20X is the 128 MB
	  M14D1G1664A (8-bank) part. All run DDR 500 MHz - the
	  clock is identical, only the DRAM geometry differs.

config T20_VARIANT_T20N
	bool "T20N (CPU 860 MHz, DDR 500, 64 MB)"

config T20_VARIANT_T20L
	bool "T20L / lite (CPU 712 MHz, DDR 500, 64 MB)"

config T20_VARIANT_T20X
	bool "T20X (CPU 860 MHz, DDR 500, 128 MB)"

endchoice

config T20_VARIANT_NAME
	string
	default "T20L" if T20_VARIANT_T20L
	default "T20X" if T20_VARIANT_T20X
	default "T20N"

config T20_DRAM_128M
	bool
	default y if T20_VARIANT_T20X
	help
	  T20X populates the 128 MB DDR2 M14D1G1664A (row 13, col
	  10, 8-bank); T20N/T20L the 64 MB M14D5121632A (4-bank).
	  Selects the matching DWC 128 MB GOLD set + REMMAP in
	  mach/t20-ddr.h. Same DDR 500 MHz clock - DWC params only.

config T20_APLL_MNOD
	hex
	default 0x03b08900 if T20_VARIANT_T20L
	default 0x04708900
	help
	  CPAPCR value, exact vendor CONFIG_SYS_APLL_MNOD (M/N/OD1/
	  OD0, OD0 in [10:8]):
	  860 = (M=71,N=2,OD1=1<<11,OD0=1<<8) = 0x04708900 (T20N);
	  712 = (M=59,N=2,OD1=1<<11,OD0=1<<8) = 0x03b08900 (T20L).

config SPL_T20_USB_BOOT
	bool "T20 SPL: return to mask ROM for USB boot (dev loop)"
	depends on SPL
	help
	  Build the SPL as a mask-ROM USB-boot stage1: bring up the
	  clocks (and DDR once ported), then return to the bootrom
	  (jr ra) instead of loading U-Boot proper from SPI-NOR -
	  how the SPL is brought up and tested on the lab rig.
	  Development only.

endif
```
