## drivers/clk/ingenic/Kconfig
```kconfig
# SPDX-License-Identifier: GPL-2.0+

config CLK_INGENIC_T31
	bool "Ingenic T31 CGU clock driver"
	depends on CLK && ARCH_XBURST
	help
	  Clock driver for the Ingenic T31 SoC Clock/Power Manager (CGU).
	  Recalculates the PLL rates programmed by the SPL and provides
	  rate/gate control for the leaf peripheral clocks (SFC, MMC,
	  GMAC) that U-Boot drives.

config CLK_INGENIC_T23
	bool "Ingenic T23 CGU clock driver"
	depends on CLK && ARCH_XBURST
	help
	  Clock driver for the Ingenic T23 SoC Clock/Power Manager (CGU).
	  Same XBurst1 CGU model as T31 (shared leaf-clock CDR/gate map)
	  minus the VPLL. Provides rate/gate control for the leaf
	  peripheral clocks (SFC, MMC, GMAC) that U-Boot drives.

config CLK_INGENIC_T21
	bool "Ingenic T21 CGU clock driver"
	depends on CLK && ARCH_XBURST
	help
	  Clock driver for the Ingenic T21 SoC Clock/Power Manager (CGU).
	  Same XBurst1 leaf-clock CDR/gate map as T31 (with VPLL), but
	  the PLL register encoding differs (cpm_cpxpcr_t). Provides
	  rate/gate control for the leaf peripheral clocks (SFC, MMC,
	  GMAC) that U-Boot drives.
```

## drivers/ram/ingenic/Kconfig
```kconfig
config RAM_INGENIC_DDR_INNOPHY
	bool "Ingenic XBurst2 DDR controller + Innophy PHY"
	depends on RAM
	depends on ARCH_XBURST
	select SPL_RAM if SPL
	help
	  Driver for the Ingenic XBurst2 DDR memory controller paired with
	  the on-chip Innophy DDR PHY (Innophy IP integrated by Ingenic on
	  T40/T41/A1 and related XBurst2 SoCs). Supports DDR2, DDR3,
	  LPDDR2 and LPDDR3 chips with hardware DQS calibration enabled by
	  default. Per-variant timing tables match by DT compatible string,
	  so a single driver instance covers every T41 SKU (T41A, T41L,
	  T41LQ, T41N, T41NQ, T41XQ, T41ZG, T41ZGC, T41ZL, T41ZM, T41ZMC,
	  T41ZN, T41ZX) and the T40 family.

	  Ported from vendor U-Boot 2013 branch T41-1.2.6
	  (arch/mips/cpu/xburst2/ddr_innophy.c).

config RAM_INGENIC_DDR_T31
	bool "Ingenic T31/T23 (XBurst1) DDR controller + Innophy PHY"
	depends on RAM
	depends on ARCH_XBURST
	select SPL_RAM if SPL
	help
	  Driver for the Ingenic T31 (XBurst1) DDR2/DDR3 memory controller
	  paired with the on-chip Innophy DDR PHY. Sibling of the XBurst2
	  driver above but a distinct IP (different register layout). The
	  per-SKU register/clock tables are selected at runtime from the DT
	  node's compatible via the driver of_match .data, so one driver
	  covers every T31 SKU (T31X, T31N, T31L, T31LC, T31AL, T31A, C100).

	  T23 reuses this driver: it has the identical legacy XBurst1 DDRC +
	  Innophy DDR2 IP, so only its per-SKU variant table (ddr_t23_types.c)
	  is added - T23N/ZN/DL/N-HP/N-LP/X/DN.

	  Ported from the vendor XBurst1 sdram_init path (formerly the inline
	  arch/mips/mach-xburst/{t31,t23}/sdram.c).

config RAM_INGENIC_DDR_T32
	bool "Ingenic T32 uMCTL2 DDR controller + Innophy PHY"
	depends on RAM
	depends on ARCH_XBURST
	select SPL_RAM if SPL
	help
	  Driver for the Ingenic T32 (vendor PRJ007) DDR memory controller:
	  a Synopsys uMCTL2-class controller paired with an Innophy training
	  PHY - a distinct IP from both the legacy XBurst1 DDRC (T10-T31)
	  and the XBurst2 controller. Supports DDR2 (soft-train), DDR3 and
	  LPDDR3 (hardware-train) chips. The per-SKU register/clock tables
	  are selected at runtime from the DT node's compatible via the
	  driver of_match .data, so one driver covers every T32 SKU (T32LQ,
	  T32VL, T32ZL, T32NQ, T32VN, T32ZN, T32XQ, T32VX, T32ZX, T32VNP).

	  Ported from the vendor U-Boot 2022.10 PRJ ddr_innophy.c (formerly
	  the inline arch/mips/mach-xburst/t32/sdram.c).
```
