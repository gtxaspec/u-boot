## configs/isvp_t32_sfcnor_defconfig
```kconfig
CONFIG_MIPS=y
CONFIG_TEXT_BASE=0x80100000
CONFIG_SYS_MALLOC_LEN=0x2000000
CONFIG_SYS_BOOTM_LEN=0x2000000
CONFIG_NR_DRAM_BANKS=1
CONFIG_DEFAULT_DEVICE_TREE="t32-isvp"
CONFIG_SYS_LOAD_ADDR=0x80600000
CONFIG_ARCH_XBURST=y
CONFIG_SOC_T32=y
CONFIG_TARGET_ISVP_T32=y
CONFIG_SPL=y
CONFIG_SPL_FRAMEWORK=y
# T32's SPL is larger than the legacy-DDRC SoCs (uMCTL2 DDR +
# Innophy soft-train + SFC2 + LZMA): give it room. QEMU presents
# DRAM at 0x80000000 from reset so this all fits; the real-silicon
# on-chip SRAM allows at least this much (DFU bring-up on T32LQ
# loaded a 9 KB SPL via the bootrom).
CONFIG_SPL_TEXT_BASE=0x80001000
CONFIG_SPL_MAX_SIZE=0x8000
CONFIG_SPL_BSS_START_ADDR=0x80009000
CONFIG_SPL_BSS_MAX_SIZE=0x2000
# CONFIG_SPL_SHARES_INIT_SP_ADDR is not set
CONFIG_SPL_HAVE_INIT_STACK=y
CONFIG_SPL_STACK=0x8000c000
CONFIG_SPL_LIBGENERIC_SUPPORT=y
CONFIG_SPL_LIBCOMMON_SUPPORT=y
CONFIG_SPL_SYS_MALLOC=y
CONFIG_BUILD_TARGET="u-boot-lzma.img"
CONFIG_LZMA=y
CONFIG_SPL_LZMA=y
CONFIG_SPL_LZMA_SIZE_OPTIMIZATION=y
CONFIG_SYS_MIPS_TIMER_FREQ=900000000
CONFIG_SKIP_LOWLEVEL_INIT=y
CONFIG_DISPLAY_CPUINFO=y
CONFIG_BOARD_INIT=y
CONFIG_OF_CONTROL=y
CONFIG_DM=y
CONFIG_DM_SERIAL=y
CONFIG_SYS_NS16550=y
CONFIG_BAUDRATE=115200
CONFIG_FIT=y
CONFIG_BOOTDELAY=2
CONFIG_DISPLAY_BOARDINFO=y
CONFIG_USE_PREBOOT=y
CONFIG_PREBOOT="sf probe"

# USB host (DWC2) + mass storage + ASIX ethernet-over-USB
CONFIG_USB=y
CONFIG_DM_USB=y
# CONFIG_SPL_DM_USB is not set
CONFIG_DM_USB_GADGET=y
CONFIG_USB_DWC2=y
CONFIG_CMD_USB=y
CONFIG_USB_STORAGE=y
CONFIG_USB_HOST_ETHER=y
CONFIG_USB_ETHER_ASIX=y

# USB gadget + DFU + UMS so the device can re-flash itself in place
CONFIG_USB_GADGET=y
CONFIG_USB_GADGET_MANUFACTURER="Ingenic"
CONFIG_USB_GADGET_VENDOR_NUM=0xa108
CONFIG_USB_GADGET_PRODUCT_NUM=0x4d44
CONFIG_USB_GADGET_DWC2_OTG=y
CONFIG_USB_GADGET_DOWNLOAD=y
CONFIG_DFU=y
CONFIG_DFU_SF=y
CONFIG_DFU_MMC=y
CONFIG_DFU_RAM=y
CONFIG_CMD_DFU=y
CONFIG_USB_FUNCTION_DFU=y
CONFIG_CMD_USB_MASS_STORAGE=y
CONFIG_USB_FUNCTION_MASS_STORAGE=y

# Networking (USB-NIC only for now - GMAC not yet ported on T32)
CONFIG_NET=y
CONFIG_NET_RANDOM_ETHADDR=y
CONFIG_CMD_NET=y
CONFIG_CMD_PING=y
CONFIG_CMD_DHCP=y
CONFIG_NETDEVICES=y
CONFIG_DM_ETH=y

# Audio: AIC + on-chip codec for U-Boot's `sound` command. The T32
# codec is a different block from the jz_t10 family (T10..T31/C100),
# so use SOUND_T32_CODEC, not SOUND_JZ_T10_CODEC.
CONFIG_SOUND=y
CONFIG_I2S=y
CONFIG_I2S_INGENIC=y
CONFIG_SOUND_T32_CODEC=y
CONFIG_CMD_SOUND=y

# SPI-NOR (SFC2) - flash chip is GD25Q127 on T32LQ but cover the
# common XBurst1 NOR vendors so any board will probe.
CONFIG_MTD=y
CONFIG_DM_SPI=y
CONFIG_SPI=y
CONFIG_SPI_INGENIC=y
CONFIG_DM_SPI_FLASH=y
CONFIG_SPI_FLASH=y
CONFIG_SPI_FLASH_GIGADEVICE=y
CONFIG_SPI_FLASH_WINBOND=y
CONFIG_SPI_FLASH_XMC=y
CONFIG_SPI_FLASH_ZBIT=y
CONFIG_SPI_FLASH_SFDP_SUPPORT=y
CONFIG_CMD_SF=y
CONFIG_CMD_SPI=y

# MMC (microSD)
CONFIG_MMC=y
CONFIG_DM_MMC=y
CONFIG_JZ47XX_MMC=y
CONFIG_CMD_MMC=y

# Block layer + partitions + filesystems (FAT/EXT4)
CONFIG_BLK=y
CONFIG_DOS_PARTITION=y
CONFIG_EFI_PARTITION=y
# CONFIG_SPL_PARTITIONS is not set
# CONFIG_SPL_DOS_PARTITION is not set
# CONFIG_SPL_EFI_PARTITION is not set
# CONFIG_SPL_PARTITION_UUIDS is not set
# CONFIG_SPL_BLK is not set
CONFIG_CMD_PART=y
CONFIG_FS_FAT=y
CONFIG_FAT_WRITE=y
CONFIG_CMD_FAT=y
CONFIG_FS_EXT4=y
CONFIG_CMD_EXT4=y
CONFIG_CMD_FS_GENERIC=y

# GPIO / pinctrl / clk / reset / watchdog
CONFIG_CMD_GPIO=y
CONFIG_CLK=y
CONFIG_CLK_INGENIC_T32=y
CONFIG_DM_GPIO=y
CONFIG_PINCTRL=y
CONFIG_PINCTRL_INGENIC=y
CONFIG_SYSRESET=y
CONFIG_SYSRESET_WATCHDOG=y
CONFIG_SYSRESET_WATCHDOG_AUTO=y
CONFIG_WDT=y
CONFIG_WDT_INGENIC=y
# CONFIG_WATCHDOG is not set
# CONFIG_WATCHDOG_AUTOSTART is not set

# Persistent environment in SPI-NOR (matches T31 layout: 64K env at
# offset 1 MiB, 64K sector erase).
# CONFIG_ENV_IS_NOWHERE is not set
CONFIG_ENV_IS_IN_SPI_FLASH=y
CONFIG_ENV_OFFSET=0x100000
CONFIG_ENV_SIZE=0x10000
CONFIG_ENV_SECT_SIZE=0x10000
```

## configs/isvp_t33_sfcnor_defconfig
```kconfig
CONFIG_MIPS=y
CONFIG_SKIP_LOWLEVEL_INIT=y
CONFIG_SYS_MALLOC_LEN=0x2000000
CONFIG_SPL_LIBCOMMON_SUPPORT=y
CONFIG_SPL_LIBGENERIC_SUPPORT=y
CONFIG_NR_DRAM_BANKS=1
CONFIG_ENV_SIZE=0x10000
CONFIG_ENV_OFFSET=0x50000
CONFIG_ENV_SECT_SIZE=0x10000
CONFIG_DM_GPIO=y
CONFIG_DEFAULT_DEVICE_TREE="t33-isvp"
CONFIG_SPL_STACK=0x8000c000
CONFIG_SPL_TEXT_BASE=0x80001000
CONFIG_SPL_BSS_START_ADDR=0x80009000
CONFIG_SPL_BSS_MAX_SIZE=0x2000
CONFIG_SYS_BOOTM_LEN=0x2000000
CONFIG_SYS_LOAD_ADDR=0x80600000
CONFIG_SPL=y
CONFIG_ARCH_XBURST=y
CONFIG_SOC_T33=y
CONFIG_TARGET_ISVP_T33=y
CONFIG_BUILD_TARGET="u-boot-lzma.img"
CONFIG_SYS_MIPS_TIMER_FREQ=950000000
CONFIG_FIT=y
CONFIG_DISPLAY_CPUINFO=y
CONFIG_BOARD_INIT=y
CONFIG_SPL_MAX_SIZE=0x8000
# CONFIG_SPL_SHARES_INIT_SP_ADDR is not set
CONFIG_SPL_HAVE_INIT_STACK=y
CONFIG_SPL_SYS_MALLOC=y
CONFIG_CMD_GPIO=y
CONFIG_CMD_SPI=y
CONFIG_ENV_IS_IN_SPI_FLASH=y
CONFIG_CLK=y
CONFIG_CLK_INGENIC_T33=y
CONFIG_MTD=y
CONFIG_DM_SPI_FLASH=y
CONFIG_SPI_FLASH_SFDP_SUPPORT=y
CONFIG_SPI_FLASH_BOYA=y
CONFIG_SPI_FLASH_EON=y
CONFIG_SPI_FLASH_FIDELIX=y
CONFIG_SPI_FLASH_FUDAN=y
CONFIG_SPI_FLASH_GIGADEVICE=y
CONFIG_SPI_FLASH_MACRONIX=y
CONFIG_SPI_FLASH_PUYA=y
CONFIG_SPI_FLASH_WINBOND=y
CONFIG_SPI_FLASH_XMC=y
CONFIG_SPI_FLASH_ZBIT=y
CONFIG_PINCTRL=y
CONFIG_PINCTRL_INGENIC=y
CONFIG_DM_SERIAL=y
CONFIG_SYS_NS16550=y
CONFIG_SPI=y
CONFIG_DM_SPI=y
CONFIG_SPI_INGENIC=y
CONFIG_SYSRESET=y
CONFIG_SYSRESET_WATCHDOG=y
CONFIG_SYSRESET_WATCHDOG_AUTO=y
# CONFIG_WATCHDOG is not set
# CONFIG_WATCHDOG_AUTOSTART is not set
CONFIG_WDT_INGENIC=y
CONFIG_LZMA=y
CONFIG_SPL_LZMA=y
CONFIG_SPL_LZMA_SIZE_OPTIMIZATION=y
```

## configs/isvp_t40xp_nandprobe_defconfig
```kconfig
CONFIG_MIPS=y
CONFIG_SKIP_LOWLEVEL_INIT=y
CONFIG_SYS_MALLOC_LEN=0x2000000
CONFIG_SPL_LIBCOMMON_SUPPORT=y
CONFIG_SPL_LIBGENERIC_SUPPORT=y
CONFIG_NR_DRAM_BANKS=1
CONFIG_ENV_SIZE=0x10000
CONFIG_ENV_OFFSET=0x100000
CONFIG_ENV_SECT_SIZE=0x10000
CONFIG_DM_GPIO=y
CONFIG_DEFAULT_DEVICE_TREE="t40xp-isvp"
CONFIG_SPL_STACK=0x80008000
CONFIG_SPL_TEXT_BASE=0x80001000
CONFIG_SPL_BSS_START_ADDR=0x80007000
CONFIG_SPL_BSS_MAX_SIZE=0x800
CONFIG_SYS_BOOTM_LEN=0x2000000
CONFIG_SYS_LOAD_ADDR=0x80600000
CONFIG_SPL=y
CONFIG_ARCH_XBURST=y
CONFIG_SOC_T40=y
CONFIG_TARGET_ISVP_T40=y
CONFIG_BUILD_TARGET="u-boot-lzma.img"
CONFIG_SYS_MIPS_TIMER_FREQ=1404000000
CONFIG_DISPLAY_CPUINFO=y
CONFIG_BOARD_INIT=y
CONFIG_SPL_MAX_SIZE=0x6000
# CONFIG_SPL_SHARES_INIT_SP_ADDR is not set
CONFIG_SPL_HAVE_INIT_STACK=y
CONFIG_SPL_SYS_MALLOC=y
CONFIG_CLK=y
CONFIG_CLK_INGENIC_T40=y
CONFIG_DM_SERIAL=y
CONFIG_SYS_NS16550=y
# CONFIG_BINMAN_FDT is not set
CONFIG_LZMA=y
CONFIG_SPL_LZMA=y
CONFIG_T40_VARIANT_T40XP=y
CONFIG_SPL_T40_NAND_PROBE_BOOT=y
```

## configs/isvp_t41_usbboot_defconfig
```kconfig
CONFIG_MIPS=y
CONFIG_SKIP_LOWLEVEL_INIT=y
CONFIG_SYS_MALLOC_LEN=0x2000000
CONFIG_SPL_LIBCOMMON_SUPPORT=y
CONFIG_SPL_LIBGENERIC_SUPPORT=y
CONFIG_NR_DRAM_BANKS=1
CONFIG_DM_GPIO=y
CONFIG_DEFAULT_DEVICE_TREE="t41lq-isvp-dfu"
CONFIG_CLK=y
CONFIG_CLK_INGENIC_T41=y
CONFIG_SPL_STACK=0x80018000
CONFIG_SPL_TEXT_BASE=0x80001000
CONFIG_SPL_BSS_START_ADDR=0x80012000
CONFIG_SPL_BSS_MAX_SIZE=0x2000
CONFIG_SYS_BOOTM_LEN=0x2000000
CONFIG_SYS_LOAD_ADDR=0x80600000
CONFIG_SPL=y
CONFIG_ARCH_XBURST=y
CONFIG_SOC_T41=y
CONFIG_SPL_T41_USB_BOOT=y
CONFIG_TARGET_ISVP_T41=y
CONFIG_BUILD_TARGET="u-boot-lzma.img"
CONFIG_SYS_MIPS_TIMER_FREQ=1104000000
CONFIG_FIT=y
CONFIG_BOOTDELAY=1
CONFIG_USE_BOOTCOMMAND=y
CONFIG_BOOTCOMMAND="run dfubootcmd"
CONFIG_DISPLAY_CPUINFO=y
CONFIG_BOARD_INIT=y
CONFIG_BOARD_LATE_INIT=y
CONFIG_SPL_MAX_SIZE=0x11000
# CONFIG_SPL_SHARES_INIT_SP_ADDR is not set
CONFIG_SPL_HAVE_INIT_STACK=y
CONFIG_SPL_SYS_MALLOC=y
CONFIG_CMD_DFU=y
CONFIG_CMD_DHCP=y
CONFIG_CMD_GPIO=y
CONFIG_CMD_MII=y
CONFIG_CMD_MMC=y
CONFIG_CMD_MTD=y
CONFIG_CMD_PING=y
CONFIG_CMD_SPI=y
CONFIG_CMD_USB=y
CONFIG_CMD_USB_MASS_STORAGE=y
CONFIG_NET_RANDOM_ETHADDR=y
CONFIG_PHY=y
CONFIG_PHY_ICPLUS=y
CONFIG_ETH_DESIGNWARE=y
CONFIG_ETH_DESIGNWARE_INGENIC=y
CONFIG_DM_MDIO=y
CONFIG_MMC=y
CONFIG_DM_MMC=y
CONFIG_MMC_SDHCI=y
CONFIG_MMC_SDHCI_INGENIC=y
CONFIG_DFU_RAM=y
CONFIG_DFU_SF=y
CONFIG_DFU_MTD=y
CONFIG_SET_DFU_ALT_INFO=y
CONFIG_MTD=y
CONFIG_DM_MTD=y
CONFIG_MTD_SPI_NAND=y
CONFIG_DM_SPI_FLASH=y
CONFIG_SPI_FLASH_SFDP_SUPPORT=y
CONFIG_SPI_FLASH_BOYA=y
CONFIG_SPI_FLASH_EON=y
CONFIG_SPI_FLASH_FIDELIX=y
CONFIG_SPI_FLASH_FUDAN=y
CONFIG_SPI_FLASH_GIGADEVICE=y
CONFIG_SPI_FLASH_MACRONIX=y
CONFIG_SPI_FLASH_PUYA=y
CONFIG_SPI_FLASH_WINBOND=y
CONFIG_SPI_FLASH_XMC=y
CONFIG_SPI_FLASH_ZBIT=y
CONFIG_SPI_FLASH_XTX=y
CONFIG_SPI_FLASH_DOSILICON=y
CONFIG_PINCTRL=y
CONFIG_PINCTRL_INGENIC=y
CONFIG_DM_SERIAL=y
CONFIG_SYS_NS16550=y
CONFIG_SPI=y
CONFIG_DM_SPI=y
CONFIG_SPI_INGENIC=y
CONFIG_USB=y
# CONFIG_SPL_DM_USB is not set
CONFIG_USB_DWC2=y
CONFIG_USB_STORAGE=y
CONFIG_DM_USB_GADGET=y
CONFIG_USB_GADGET=y
CONFIG_USB_GADGET_MANUFACTURER="Ingenic"
CONFIG_USB_GADGET_VENDOR_NUM=0xa108
CONFIG_USB_GADGET_PRODUCT_NUM=0x4d44
CONFIG_USB_GADGET_DWC2_OTG=y
CONFIG_USB_GADGET_DWC2_OTG_FORCE_DEV_MODE=y
CONFIG_USB_GADGET_DOWNLOAD=y
# CONFIG_BINMAN_FDT is not set
CONFIG_LZMA=y
CONFIG_SPL_LZMA=y
CONFIG_RAM=y
CONFIG_SPL_RAM=y
CONFIG_SPL_OF_CONTROL=y
CONFIG_SPL_OF_LIBFDT=y
CONFIG_SPL_SERIAL=y
CONFIG_RAM_INGENIC_DDR_INNOPHY=y
CONFIG_SYSRESET=y
CONFIG_SYSRESET_WATCHDOG=y
CONFIG_SYSRESET_WATCHDOG_AUTO=y
# CONFIG_WATCHDOG_AUTOSTART is not set
CONFIG_WDT_INGENIC=y
```

## configs/isvp_t41lq_sfcnor_defconfig
```kconfig
CONFIG_MIPS=y
CONFIG_SKIP_LOWLEVEL_INIT=y
CONFIG_SYS_MALLOC_LEN=0x2000000
CONFIG_SPL_LIBCOMMON_SUPPORT=y
CONFIG_SPL_LIBGENERIC_SUPPORT=y
CONFIG_NR_DRAM_BANKS=1
CONFIG_ENV_SIZE=0x10000
CONFIG_ENV_OFFSET=0x50000
CONFIG_ENV_SECT_SIZE=0x10000
CONFIG_DM_GPIO=y
CONFIG_SPL_DM_SPI=y
CONFIG_DEFAULT_DEVICE_TREE="t41lq-isvp"
CONFIG_SPL_SYS_MALLOC_F_LEN=0x4000
CONFIG_SPL_SERIAL=y
CONFIG_SPL_STACK=0x8001f000
CONFIG_SPL_TEXT_BASE=0x80001000
CONFIG_SPL_BSS_START_ADDR=0x80014000
CONFIG_SPL_BSS_MAX_SIZE=0x2000
CONFIG_SYS_BOOTM_LEN=0x2000000
CONFIG_SYS_LOAD_ADDR=0x80600000
CONFIG_SPL=y
CONFIG_SPL_SPI_FLASH_SUPPORT=y
CONFIG_SPL_SPI=y
CONFIG_ARCH_XBURST=y
CONFIG_SOC_T41=y
CONFIG_TARGET_ISVP_T41=y
CONFIG_BUILD_TARGET="u-boot-lzma.img"
CONFIG_SYS_MIPS_TIMER_FREQ=1104000000
CONFIG_DISPLAY_CPUINFO=y
CONFIG_BOARD_INIT=y
CONFIG_SPL_MAX_SIZE=0x13000
# CONFIG_SPL_SHARES_INIT_SP_ADDR is not set
CONFIG_SPL_HAVE_INIT_STACK=y
CONFIG_SPL_SYS_MALLOC=y
CONFIG_SPL_HAS_CUSTOM_MALLOC_START=y
CONFIG_SPL_CUSTOM_SYS_MALLOC_ADDR=0x80800000
CONFIG_SPL_SYS_MALLOC_SIZE=0x400000
CONFIG_SPL_DM_SPI_FLASH=y
CONFIG_SPL_SPI_LOAD=y
CONFIG_SYS_SPI_U_BOOT_OFFS=0x10000
CONFIG_HUSH_PARSER=y
CONFIG_CMD_GPIO=y
CONFIG_CMD_MMC=y
CONFIG_CMD_PART=y
CONFIG_CMD_USB=y
CONFIG_CMD_DHCP=y
CONFIG_CMD_MII=y
CONFIG_CMD_PING=y
CONFIG_CMD_SOUND=y
CONFIG_CMD_EXT4=y
CONFIG_CMD_FAT=y
CONFIG_CMD_FS_GENERIC=y
# CONFIG_SPL_DOS_PARTITION is not set
CONFIG_EFI_PARTITION=y
# CONFIG_SPL_EFI_PARTITION is not set
CONFIG_SPL_OF_CONTROL=y
CONFIG_OF_SPL_REMOVE_PROPS="pinctrl-names interrupt-parent interrupts"
CONFIG_ENV_IS_IN_SPI_FLASH=y
CONFIG_NET_RANDOM_ETHADDR=y
CONFIG_CLK=y
CONFIG_CLK_INGENIC_T41=y
CONFIG_MMC=y
CONFIG_MMC_SDHCI_INGENIC=y
CONFIG_MMC_SDHCI=y
CONFIG_MTD=y
CONFIG_DM_SPI_FLASH=y
CONFIG_SPI_FLASH_SFDP_SUPPORT=y
CONFIG_SPI_FLASH_BOYA=y
CONFIG_SPI_FLASH_DOSILICON=y
CONFIG_SPI_FLASH_EON=y
CONFIG_SPI_FLASH_FIDELIX=y
CONFIG_SPI_FLASH_FUDAN=y
CONFIG_SPI_FLASH_GIGADEVICE=y
CONFIG_SPI_FLASH_MACRONIX=y
CONFIG_SPI_FLASH_PUYA=y
CONFIG_SPI_FLASH_WINBOND=y
CONFIG_SPI_FLASH_XMC=y
CONFIG_SPI_FLASH_XTX=y
CONFIG_SPI_FLASH_ZBIT=y
CONFIG_DM_MDIO=y
CONFIG_ETH_DESIGNWARE=y
CONFIG_ETH_DESIGNWARE_INGENIC=y
CONFIG_PHY_ICPLUS=y
CONFIG_PHY=y
CONFIG_PINCTRL=y
CONFIG_PINCTRL_INGENIC=y
CONFIG_RAM=y
CONFIG_RAM_INGENIC_DDR_INNOPHY=y
CONFIG_DM_SERIAL=y
CONFIG_SYS_NS16550=y
CONFIG_SOUND=y
CONFIG_I2S=y
CONFIG_I2S_INGENIC=y
CONFIG_SPI=y
CONFIG_DM_SPI=y
CONFIG_SPI_INGENIC=y
CONFIG_SYSRESET=y
CONFIG_SYSRESET_WATCHDOG=y
CONFIG_SYSRESET_WATCHDOG_AUTO=y
CONFIG_USB=y
# CONFIG_SPL_DM_USB is not set
CONFIG_USB_DWC2=y
CONFIG_USB_HOST_ETHER=y
CONFIG_USB_ETHER_ASIX=y
CONFIG_USB_ETHER_ASIX88179=y
CONFIG_USB_ETHER_MCS7830=y
CONFIG_USB_ETHER_RTL8152=y
CONFIG_USB_ETHER_SMSC95XX=y
# CONFIG_WATCHDOG_AUTOSTART is not set
CONFIG_WDT_INGENIC=y
CONFIG_FAT_WRITE=y
# CONFIG_BINMAN_FDT is not set
CONFIG_LZMA=y
CONFIG_SPL_LZMA=y
```

## configs/isvp_t41nq_sfcnor_defconfig
```kconfig
CONFIG_MIPS=y
CONFIG_SKIP_LOWLEVEL_INIT=y
CONFIG_SYS_MALLOC_LEN=0x2000000
CONFIG_SPL_LIBCOMMON_SUPPORT=y
CONFIG_SPL_LIBGENERIC_SUPPORT=y
CONFIG_NR_DRAM_BANKS=1
CONFIG_ENV_SIZE=0x10000
CONFIG_ENV_OFFSET=0x100000
CONFIG_ENV_SECT_SIZE=0x10000
CONFIG_DM_GPIO=y
CONFIG_DEFAULT_DEVICE_TREE="t41-isvp"
CONFIG_SPL_STACK=0x80008000
CONFIG_SPL_TEXT_BASE=0x80001000
CONFIG_SPL_BSS_START_ADDR=0x80007800
CONFIG_SPL_BSS_MAX_SIZE=0x800
CONFIG_SYS_BOOTM_LEN=0x2000000
CONFIG_SYS_LOAD_ADDR=0x80600000
CONFIG_SPL=y
CONFIG_ARCH_XBURST=y
CONFIG_SOC_T41=y
CONFIG_TARGET_ISVP_T41=y
CONFIG_BUILD_TARGET="u-boot-lzma.img"
CONFIG_SYS_MIPS_TIMER_FREQ=1104000000
CONFIG_DISPLAY_CPUINFO=y
CONFIG_BOARD_INIT=y
CONFIG_SPL_MAX_SIZE=0x6800
# CONFIG_SPL_SHARES_INIT_SP_ADDR is not set
CONFIG_SPL_HAVE_INIT_STACK=y
CONFIG_SPL_SYS_MALLOC=y
CONFIG_CMD_GPIO=y
CONFIG_CMD_MII=y
CONFIG_CMD_MMC=y
CONFIG_CMD_USB=y
CONFIG_CMD_DHCP=y
CONFIG_CMD_PING=y
CONFIG_ENV_IS_IN_SPI_FLASH=y
CONFIG_NET_RANDOM_ETHADDR=y
CONFIG_PHY=y
CONFIG_PHY_ICPLUS=y
CONFIG_ETH_DESIGNWARE=y
CONFIG_ETH_DESIGNWARE_INGENIC=y
CONFIG_DM_MDIO=y
CONFIG_CLK=y
CONFIG_CLK_INGENIC_T41=y
CONFIG_MMC=y
CONFIG_DM_MMC=y
CONFIG_MMC_SDHCI=y
CONFIG_MMC_SDHCI_INGENIC=y
CONFIG_MTD=y
CONFIG_DM_SPI_FLASH=y
CONFIG_SPI_FLASH_SFDP_SUPPORT=y
CONFIG_SPI_FLASH_GIGADEVICE=y
CONFIG_SPI_FLASH_MACRONIX=y
CONFIG_SPI_FLASH_WINBOND=y
CONFIG_SPI_FLASH_XMC=y
CONFIG_SPI_FLASH_ZBIT=y
CONFIG_PINCTRL=y
CONFIG_PINCTRL_INGENIC=y
CONFIG_DM_SERIAL=y
CONFIG_SYSRESET=y
CONFIG_SYSRESET_WATCHDOG=y
CONFIG_SYSRESET_WATCHDOG_AUTO=y
# CONFIG_WATCHDOG_AUTOSTART is not set
CONFIG_WDT_INGENIC=y
CONFIG_SYS_NS16550=y
CONFIG_SPI=y
CONFIG_DM_SPI=y
CONFIG_SPI_INGENIC=y
CONFIG_USB=y
# CONFIG_SPL_DM_USB is not set
CONFIG_USB_DWC2=y
CONFIG_USB_HOST_ETHER=y
CONFIG_USB_ETHER_ASIX=y
CONFIG_CMD_SOUND=y
CONFIG_SOUND=y
CONFIG_I2S=y
CONFIG_I2S_INGENIC=y
CONFIG_SOUND_JZ_T10_CODEC=y
CONFIG_LZMA=y
CONFIG_SPL_LZMA=y
CONFIG_RAM=y
CONFIG_RAM_INGENIC_DDR_INNOPHY=y
CONFIG_T41_VARIANT_T41NQ=y
```

## configs/isvp_t41nq_usbboot_defconfig
```kconfig
CONFIG_MIPS=y
CONFIG_SKIP_LOWLEVEL_INIT=y
CONFIG_SYS_MALLOC_LEN=0x2000000
CONFIG_SPL_LIBCOMMON_SUPPORT=y
CONFIG_SPL_LIBGENERIC_SUPPORT=y
CONFIG_NR_DRAM_BANKS=1
CONFIG_DM_GPIO=y
CONFIG_DEFAULT_DEVICE_TREE="t40-isvp-dfu"
CONFIG_CLK=y
CONFIG_CLK_INGENIC_T40=y
CONFIG_SPL_STACK=0x80008000
CONFIG_SPL_TEXT_BASE=0x80001000
CONFIG_SPL_BSS_START_ADDR=0x80007000
CONFIG_SPL_BSS_MAX_SIZE=0x800
CONFIG_SYS_BOOTM_LEN=0x2000000
CONFIG_SYS_LOAD_ADDR=0x80600000
CONFIG_SPL=y
CONFIG_ARCH_XBURST=y
CONFIG_SOC_T41=y
CONFIG_SPL_T41_USB_BOOT=y
CONFIG_TARGET_ISVP_T41=y
CONFIG_BUILD_TARGET="u-boot-lzma.img"
CONFIG_SYS_MIPS_TIMER_FREQ=1104000000
CONFIG_BOOTDELAY=1
CONFIG_DISPLAY_CPUINFO=y
CONFIG_BOARD_INIT=y
CONFIG_SPL_MAX_SIZE=0x6000
# CONFIG_SPL_SHARES_INIT_SP_ADDR is not set
CONFIG_SPL_HAVE_INIT_STACK=y
CONFIG_SPL_SYS_MALLOC=y
CONFIG_CMD_GPIO=y
CONFIG_CMD_USB=y
CONFIG_NET_RANDOM_ETHADDR=y
CONFIG_PINCTRL=y
CONFIG_PINCTRL_INGENIC=y
CONFIG_DM_SERIAL=y
CONFIG_SYS_NS16550=y
CONFIG_USB=y
# CONFIG_SPL_DM_USB is not set
CONFIG_USB_DWC2=y
# CONFIG_BINMAN_FDT is not set
CONFIG_LZMA=y
CONFIG_SPL_LZMA=y
CONFIG_T41_VARIANT_T41NQ=y
```
